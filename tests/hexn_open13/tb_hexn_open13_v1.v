`timescale 1ns/1ps
// tb_hexn_open13_v1: the CHAIN OF GATED UNITS WITH BYPASS (hexn_unit_v2) in the open unit v13 over SPI: pattern-bank slots applied through the gate, operand batches run through the 18-bit block. The script is generated by tests/vm/test_hexn_open12_v1.py (see the SCRIPT marker below).
module tb;
    reg clk = 0; always #5 clk = ~clk;
    reg key = 0;
    wire SPI_MISO, READY; wire [5:0] led;
    tri1 [15:0] pool;
//MASTER//
    hexn_open_top_v13 #(.NU(4), .TICK(10), .DEBMS(3), .RSTW(4)) T (.BOARD_CLK(clk), .KEY_S1(key), .SPI_SCLK(sclk), .SPI_CS_N(cs_n), .SPI_MOSI(mosi), .SPI_MISO(SPI_MISO), .READY(READY), .POOL(pool), .LED_N(led));
    defparam T.SH.DWELL = 20; defparam T.SH.HALF = 2;
    integer fails = 0, i, bad, seq = 70, useq = 0; reg [8*200:1] dir, fn;
    reg [31:0] opm [0:255]; reg [31:0] exm [0:127]; reg [31:0] bank [0:63];
    localparam SENT = 32'hDEADBEEF;
    task check(input cond, input [639:0] what); begin if (!cond) begin $display("FAIL %0s", what); fails = fails + 1; end else $display("ok %0s", what); end endtask
    task wait_idle; begin repeat (6) @(negedge clk); rd_reg(8'd10); while (rv[4]) rd_reg(8'd10); end endtask
    task sentinel(input [15:0] a, input integer n); begin for (i = 0; i < n; i = i + 1) wbuf[i] = SENT; wr_words(a, n); end endtask
    task load(input [3:0] sp, input [15:0] base, input integer n); begin wr_reg(8'd17, {sp, 12'd0, 16'd0} | (base << 16) | n); seq = seq + 1; wr_reg(8'd19, seq); repeat (6) @(negedge clk); rd_reg(8'd10); while (rv[4]) rd_reg(8'd10); end endtask
    task save(input [3:0] sp, input [15:0] base, input integer n); begin wr_reg(8'd30, {sp, 12'd0, 16'd0} | (base << 16) | n); seq = seq + 1; wr_reg(8'd31, seq); repeat (6) @(negedge clk); rd_reg(8'd10); while (rv[4]) rd_reg(8'd10); end endtask
    task ucmd(input [3:0] op, input [9:0] base, input [9:0] cnt, input [3:0] unit, input [5:0] slot); begin useq = useq + 1; wr_reg(8'd18, {op, useq[3:0], base, 10'd0, 4'd0} | (cnt << 4) | (unit << 8) | slot); end endtask
    // PROGRAM n units from bank slot `slot` (n = 0 means all); the n status words are read back from scratch[sbase..]
    task chainprog(input [5:0] slot, input [3:0] n, input [9:0] sbase, input integer nn, input [639:0] what); integer j; reg okk; begin
        for (j = 0; j < 8; j = j + 1) wbuf[j] = SENT; wr_words(sbase, 8); ucmd(4'd3, sbase, 10'd0, n, slot); wait_idle; rd_words(sbase, 8); okk = 1;
        for (j = 0; j < nn; j = j + 1) if (rbuf[j] !== 32'd0) okk = 0; for (j = nn; j < 8; j = j + 1) if (rbuf[j] !== SENT) okk = 0; check(okk, what); end endtask
    task apply1(input [3:0] unit, input [5:0] slot, input [9:0] sbase, input [639:0] what); begin sentinel(sbase, 4); ucmd(4'd1, sbase, 10'd0, unit, slot); wait_idle; rd_words(sbase, 2); check(rbuf[0] === 32'd0 && rbuf[1] === SENT, what); end endtask
    // run a batch: operands from <dir>/op<id>.hex (2*count words), expected results from <dir>/ex<id>.hex
    task run_batch(input integer id, input [9:0] cnt, input [639:0] what);
        reg [9:0] base; begin
        base = 10'd100; $sformat(fn, "%0s/op%0d.hex", dir, id); $readmemh(fn, opm); $sformat(fn, "%0s/ex%0d.hex", dir, id); $readmemh(fn, exm);
        for (i = 0; i < 2 * cnt; i = i + 1) wbuf[i] = opm[i]; wr_words(16'd100, 2 * cnt); sentinel(16'd100 + 2 * cnt, cnt + 2);
        ucmd(4'd2, base, cnt, 4'd0, 6'd0); wait_idle; rd_words(16'd100 + 2 * cnt, cnt + 1); bad = 0; for (i = 0; i < cnt; i = i + 1) if (rbuf[i] !== exm[i]) begin bad = bad + 1; if (bad < 4) $display("  word %0d: got %h expected %h", i, rbuf[i], exm[i]); end
        check(bad == 0 && rbuf[cnt] === SENT, what); end endtask
    initial begin
        if (!$value$plusargs("dir=%s", dir)) begin $display("FAIL args"); $finish; end
        wait (T.init_done); repeat (40) @(negedge clk);
//SCRIPT//
        if (fails == 0) $display("PASS"); else $display("FAIL %0d", fails);
        $finish;
    end
    initial begin repeat (80000000) @(posedge clk); $display("TIMEOUT"); $finish; end
endmodule
