// top_wrapped_experimental_1cell_v1.v — points.md #552/#554: real, generated 1-cell array,
// 1x1 row-major grid, unicell_super_v3 per cell.
// Generated by tools/project_assemble_v1.py -- do not hand-edit;
// regenerate from the same command instead.
//
// REAL FIX (#554), found from a real, honest Quartus result: the first
// version of this generator tied cfg_valid=0 PERMANENTLY on every cell.
// unicell_stripped_v1.v's own real config register only updates `if
// (cfg_valid)` -- with cfg_valid permanently false, Quartus could PROVE
// every cell's own SUPER_LATCH register never leaves its reset value
// (nano, topology=0), for all 500 cells identically. That's not just
// prunable dead logic -- it's a huge network of PROVABLY IDENTICAL,
// fully-determined NOR-gate trees, exactly the shape Quartus's own
// Boolean optimizer collapses aggressively (real result: 13 ALM for
// 500 cells). Fixed here with a real, one-shot, broadcast config-load
// pulse a few cycles after reset, loading a genuinely unconstrained
// top-level input into every cell's own core_select field
// simultaneously -- Quartus cannot prove which of the 8 real cores
// ends up selected for any given cell, so it cannot collapse any of
// them away.
`default_nettype none
`timescale 1ns / 1ps

module top_wrapped_experimental_1cell_v1 (
    input  wire CLK_100M,
    input  wire ENTRY_DATA,      // real, unconstrained -- feeds the array's own entry point
    input  wire [4:0] CFG_SELECT, // real, unconstrained -- broadcast core_select, see header
    output wire LED0_N,
    output wire LED1_N
);

reg [1:0] div_cnt = 2'b00;
always @(posedge CLK_100M) div_cnt <= div_cnt + 2'd1;
wire clk = div_cnt[1];   // 25 MHz

reg [3:0] rst_sr = 4'hF;
always @(posedge clk) rst_sr <= {rst_sr[2:0], 1'b0};
wire rst = rst_sr[3];

// Real, one-shot, broadcast config-load pulse -- fires exactly once,
// a few cycles after reset, simultaneously to every cell in the array.
reg [3:0] cfg_pulse_sr = 4'hF;
always @(posedge clk) if (!rst) cfg_pulse_sr <= {cfg_pulse_sr[2:0], 1'b0};
wire cfg_valid_bcast = !rst && cfg_pulse_sr[3] && !cfg_pulse_sr[2];   // one real cycle

// Real, genuinely unconstrained SUPER_LATCH value broadcast to every
// cell -- core_select from CFG_SELECT (real top-level input, cannot be
// proven constant), remaining core_config/addon_config bits filled from
// ENTRY_DATA repeated rather than left as a hardcoded, provably-known
// constant (still not truly random, but no longer provably fixed).
wire [79:0] cfg_data_bcast = {13'b0, {20{ENTRY_DATA}}, {42{ENTRY_DATA}}, CFG_SELECT};

// Real entry point: ONE cell's own N-side arrival is driven from a
// genuine, unconstrained top-level input.
wire [31:0] entry_data = {31'b0, ENTRY_DATA};

wire [31:0] C_0_0_dout_n, C_0_0_dout_s, C_0_0_dout_e, C_0_0_dout_w;
wire C_0_0_fire_n, C_0_0_fire_s, C_0_0_fire_e, C_0_0_fire_w;
wire C_0_0_ack_n, C_0_0_ack_s, C_0_0_ack_e, C_0_0_ack_w;

unicell_super_v3_wrapped_experimental #(.CELL_ID(16'h1000)) C_0_0 (
    .clk(clk), .rst(rst),
    .cfg_valid(cfg_valid_bcast), .cfg_data(cfg_data_bcast),
    .data_in_n(entry_data), .data_in_s(32'h0),
    .data_in_e(32'h0), .data_in_w(32'h0),
    .arrived_n(ENTRY_DATA), .arrived_s(1'b0),
    .arrived_e(1'b0), .arrived_w(1'b0),
    .data_out_n(C_0_0_dout_n), .data_out_s(C_0_0_dout_s), .data_out_e(C_0_0_dout_e), .data_out_w(C_0_0_dout_w),
    .fire_n(C_0_0_fire_n), .fire_s(C_0_0_fire_s), .fire_e(C_0_0_fire_e), .fire_w(C_0_0_fire_w),
    .ready_out(), .ready_in_n(1'b1), .ready_in_s(1'b1), .ready_in_e(1'b1), .ready_in_w(1'b1),
    .ack_out_n(C_0_0_ack_n), .ack_out_s(C_0_0_ack_s), .ack_out_e(C_0_0_ack_e), .ack_out_w(C_0_0_ack_w),
    .ack_in_n(1'b0), .ack_in_s(1'b0), .ack_in_e(1'b0), .ack_in_w(1'b0),
    .freeze_in(1'b0),
    .program_in(1'b0), .program_done(),
    .prog_data_in_n(32'h0), .prog_data_in_s(32'h0), .prog_data_in_e(32'h0), .prog_data_in_w(32'h0),
    .prog_arrived_in_n(1'b0), .prog_arrived_in_s(1'b0), .prog_arrived_in_e(1'b0), .prog_arrived_in_w(1'b0),
    .status_core_select()
);

// Real anti-pruning guard: every cell's own fire_* outputs XOR-reduced
// into one real, observable signal -- Quartus cannot prove this
// constant (it structurally depends on ENTRY_DATA's own real fanout),
// so it cannot prune any contributing cell away.
wire array_alive = C_0_0_fire_n ^ C_0_0_fire_s ^ C_0_0_fire_e ^ C_0_0_fire_w ^ C_0_0_dout_n[0] ^ C_0_0_dout_s[0] ^ C_0_0_dout_e[0] ^ C_0_0_dout_w[0];

reg [23:0] hb_cnt = 0;
always @(posedge clk) hb_cnt <= hb_cnt + 24'd1;

assign LED0_N = ~hb_cnt[23];
assign LED1_N = ~array_alive;   // real, observable, non-prunable

// Real, JTAG-readable confirmation (points.md #529/#537's own proven
// pattern) -- added BEFORE the first real build, not after, so a real
// silicon check doesn't need a second ~2-hour rebuild just to add it.
// probe[0]=array_alive (a real snapshot of the array's own current
// state), probe[1]=heartbeat (continuously toggling, proves the design
// is genuinely clocking -- use debug_issp_poll.tcl, not the older fixed-
// gap script, per #537's own real aliasing finding).
debug_issp_probe_v1 DEBUG_PROBE (
    .err_sticky(array_alive),
    .heartbeat(hb_cnt[23])
);

endmodule
