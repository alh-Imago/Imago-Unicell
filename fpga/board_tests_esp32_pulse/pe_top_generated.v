// pe_top.v -- GENERATED by tools/board_esp32_pulse_v1.py (ledger #1227). P1: Tang pulses of 12 widths into the ESP32; the ESP32 toggles an answer pin per handler run. Do not hand-edit.
`default_nettype none
module pe_top #(parameter [63:0] NAME = "pe_quiet", parameter integer STORM = 0, parameter integer NP = 512, parameter integer CPB = 234,
                parameter integer WARM = 27000000, parameter integer REPEAT = 40000000, parameter integer PRET = 2700000, parameter integer HALF = 1350000, parameter integer RAND_W = 15,
                parameter integer SPER = 700, parameter integer SRND = 11) (
    input  wire BOARD_CLK, output wire UART_TX, input wire RESP, output wire STIM, output wire STORMP,
    output wire LED0_N, output wire LED1_N, output wire LED2_N, output wire LED3_N, output wire LED4_N, output wire LED5_N
);
    wire clk = BOARD_CLK;
    function [7:0] hx(input [3:0] n); hx = (n < 4'd10) ? (8'd48 + {4'b0, n}) : (8'd55 + {4'b0, n}); endfunction
    function [63:0] h8(input [31:0] v); h8 = {hx(v[31:28]), hx(v[27:24]), hx(v[23:20]), hx(v[19:16]), hx(v[15:12]), hx(v[11:8]), hx(v[7:4]), hx(v[3:0])}; endfunction

    reg [15:0] rcnt = 0; wire rst = ~&rcnt; always @(posedge clk) if (rst) rcnt <= rcnt + 1'b1;
    reg resp_a = 1'b0, resp_s = 1'b0; always @(posedge clk) begin resp_a <= RESP; resp_s <= resp_a; end
    reg [31:0] now = 32'd0; always @(posedge clk) now <= now + 1'b1;
    reg [31:0] lf = 32'hACE1BEEF; always @(posedge clk) lf <= {lf[30:0], lf[31] ^ lf[21] ^ lf[1] ^ lf[0]};
    reg [31:0] lg = 32'h1BADB002; always @(posedge clk) lg <= {lg[30:0], lg[31] ^ lg[21] ^ lg[1] ^ lg[0]};
    function [31:0] wval(input [3:0] i); begin case (i) 4'd0: wval = 32'd2700; 4'd1: wval = 32'd1350; 4'd2: wval = 32'd540; 4'd3: wval = 32'd270; 4'd4: wval = 32'd135; 4'd5: wval = 32'd54; 4'd6: wval = 32'd27; 4'd7: wval = 32'd16; 4'd8: wval = 32'd8; 4'd9: wval = 32'd4; 4'd10: wval = 32'd2; 4'd11: wval = 32'd1; default: wval = 32'd1; endcase end endfunction
    reg [31:0] cg0 = 32'd0; reg [31:0] cg1 = 32'd0; reg [31:0] cg2 = 32'd0; reg [31:0] cg3 = 32'd0; reg [31:0] cg4 = 32'd0; reg [31:0] cg5 = 32'd0; reg [31:0] cg6 = 32'd0; reg [31:0] cg7 = 32'd0; reg [31:0] cg8 = 32'd0; reg [31:0] cg9 = 32'd0; reg [31:0] cg10 = 32'd0; reg [31:0] cg11 = 32'd0;
    reg stim_r = 1'b0; assign STIM = stim_r;
    reg storm_r = 1'b0; assign STORMP = storm_r;
    reg [3:0] st = 4'd0, wi = 4'd0; reg [31:0] cnt = 32'd0, pn = 32'd0, pre_hit = 32'd0, pre_n = 32'd0, pre_t = 32'd0; reg ans0 = 1'b0;
    localparam S_WARM = 0, S_PRE = 1, S_GAP = 2, S_HI = 3, S_WATCH = 4, S_DONE = 7;
    wire storm_on = (STORM != 0) && (st >= S_GAP) && (st != S_DONE);
    reg [31:0] sc = 32'd0;
    always @(posedge clk) begin
        if (!storm_on) sc <= 32'd0;
        else if (sc == 0) begin storm_r <= ~storm_r; sc <= SPER + {21'd0, lg[SRND-1:0]}; end
        else sc <= sc - 1'b1;
    end
    wire caught = (resp_s != ans0);
    always @(posedge clk) begin
        case (st)
            S_WARM: if (!rst && now > WARM) begin st <= S_PRE; pre_t <= 32'd0; end
            S_PRE: begin
                pre_t <= pre_t + 1'b1;
                if (pre_t == 32'd0) begin ans0 <= resp_s; stim_r <= 1'b1; end
                if (pre_t == HALF) stim_r <= 1'b0;
                if (pre_t >= PRET) begin
                    pre_t <= 32'd0; pre_n <= pre_n + 1'b1;
                    if (resp_s != ans0) pre_hit <= pre_hit + 1'b1;
                    if (pre_n == 32'd7) begin
                        if (pre_hit + ((resp_s != ans0) ? 32'd1 : 32'd0) == 32'd8) begin st <= S_GAP; cnt <= 20000 + {17'd0, lf[RAND_W-1:0]}; wi <= 4'd0; pn <= 32'd0; end
                        else st <= S_DONE;
                    end
                end
            end
            S_GAP: if (cnt == 0) begin ans0 <= resp_s; stim_r <= 1'b1; cnt <= wval(wi) - 1'b1; st <= S_HI; end else cnt <= cnt - 1'b1;
            S_HI: begin if (cnt == 0) begin stim_r <= 1'b0; cnt <= 5000; st <= S_WATCH; end else cnt <= cnt - 1'b1; end
            S_WATCH: begin
                if (cnt == 0) begin
                    case (wi) 4'd0: if (caught) cg0 <= cg0 + 1'b1; 4'd1: if (caught) cg1 <= cg1 + 1'b1; 4'd2: if (caught) cg2 <= cg2 + 1'b1; 4'd3: if (caught) cg3 <= cg3 + 1'b1; 4'd4: if (caught) cg4 <= cg4 + 1'b1; 4'd5: if (caught) cg5 <= cg5 + 1'b1; 4'd6: if (caught) cg6 <= cg6 + 1'b1; 4'd7: if (caught) cg7 <= cg7 + 1'b1; 4'd8: if (caught) cg8 <= cg8 + 1'b1; 4'd9: if (caught) cg9 <= cg9 + 1'b1; 4'd10: if (caught) cg10 <= cg10 + 1'b1; 4'd11: if (caught) cg11 <= cg11 + 1'b1; default: ; endcase
                    cnt <= 20000 + {17'd0, lf[RAND_W-1:0]};
                    if (pn + 1 == NP) begin pn <= 32'd0; if (wi == 4'd11) st <= S_DONE; else begin wi <= wi + 1'b1; st <= S_GAP; end end
                    else begin pn <= pn + 1'b1; st <= S_GAP; end
                end else cnt <= cnt - 1'b1;
            end
            default: ;
        endcase
    end
    wire done = (st == S_DONE);
    wire [7:0] res_c = (pre_hit != 32'd8) ? "L" : "P";
    wire [8*191-1:0] line = {"UCW ", NAME, " res=", res_c, " np=", h8(NP), " pre=", h8(pre_hit), " w0=", h8(cg0), " w1=", h8(cg1), " w2=", h8(cg2), " w3=", h8(cg3), " w4=", h8(cg4), " w5=", h8(cg5), " w6=", h8(cg6), " w7=", h8(cg7), " w8=", h8(cg8), " w9=", h8(cg9), " w10=", h8(cg10), " w11=", h8(cg11), "\015\n"};
    reg [7:0] ci = 8'd0; reg [31:0] rep = 32'd0; reg sending = 1'b0; reg start = 1'b0; wire busy;
    board_uart_tx #(.CPB(CPB)) T (.clk(clk), .start(start), .data(line[((191-1)-ci)*8 +: 8]), .tx(UART_TX), .busy(busy));
    always @(posedge clk) begin
        start <= 1'b0;
        if (!done) begin sending <= 1'b0; ci <= 8'd0; rep <= 32'd0; end
        else if (!sending) begin if (rep >= REPEAT || rep == 0) begin sending <= 1'b1; ci <= 8'd0; rep <= 32'd1; end else rep <= rep + 1'b1; end
        else if (start) ci <= ci + 1'b1;
        else if (!busy) begin if (ci == 191) sending <= 1'b0; else start <= 1'b1; end
    end
    reg [24:0] hb = 25'd0; always @(posedge clk) hb <= hb + 1'b1;
    assign LED0_N = ~hb[24]; assign LED1_N = ~(done && pre_hit == 32'd8); assign LED2_N = ~(done && pre_hit != 32'd8); assign LED3_N = ~done;
    assign LED4_N = ~stim_r; assign LED5_N = ~resp_s;
endmodule
`default_nettype wire
