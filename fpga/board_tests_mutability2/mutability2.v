// board_top_mutability2.v -- GENERATED by tools/board_mutability2_v1.py (ledger #1088); do not hand-edit.
`default_nettype none
`timescale 1ns / 1ps
module board_top_mutability2 #(parameter integer CPB = 234) (
    input wire BOARD_CLK, input wire UART_RX, output wire UART_TX, output wire LED0_N, output wire LED1_N, output wire LED2_N, output wire LED3_N);
wire clk = BOARD_CLK;
reg [7:0] por_cnt = 8'h00; wire rst = (por_cnt != 8'hFF); always @(posedge clk) if (rst) por_cnt <= por_cnt + 8'd1;

// ---------------- the command cell (standalone command_cell_v4, programmer mode, drives EAST into the carrier's west face)
reg cmd_cfgv = 1'b0, cmd_init_done = 1'b0;
always @(posedge clk) begin cmd_cfgv <= 1'b0; if (!rst && !cmd_init_done) begin cmd_cfgv <= 1'b1; cmd_init_done <= 1'b1; end end
reg [31:0] w_val = 32'h0; reg w_arr = 1'b0;
wire cmd_ready, cmd_active, cmd_fz_e, cmd_po_e, cmd_pa_e; wire [31:0] cmd_pd_e; wire car_pack_w, car_ack_n;
command_cell_v4 #(.CELL_ID(16'hA000)) CMD (
    .clk(clk), .rst(rst), .active(1'b1), .cfg_valid(cmd_cfgv), .cfg_data(64'h00000000000000E9),
    .data_in_n(w_val), .data_in_s(32'h0), .data_in_e(32'h0), .data_in_w(32'h0),
    .arrived_n(w_arr), .arrived_s(1'b0), .arrived_e(1'b0), .arrived_w(1'b0),
    .ack_out_n(), .ack_out_s(), .ack_out_e(), .ack_out_w(), .ready_out(cmd_ready),
    .freeze_out_n(), .freeze_out_s(), .freeze_out_e(cmd_fz_e), .freeze_out_w(),
    .program_out_n(), .program_out_s(), .program_out_e(cmd_po_e), .program_out_w(),
    .prog_data_out_n(), .prog_data_out_s(), .prog_data_out_e(cmd_pd_e), .prog_data_out_w(),
    .prog_arrived_out_n(), .prog_arrived_out_s(), .prog_arrived_out_e(cmd_pa_e), .prog_arrived_out_w(),
    .prog_ack_in_n(1'b0), .prog_ack_in_s(1'b0), .prog_ack_in_e(car_pack_w), .prog_ack_in_w(1'b0),
    .program_in(1'b0), .program_done(),
    .prog_data_in_n(32'h0), .prog_data_in_s(32'h0), .prog_data_in_e(32'h0), .prog_data_in_w(32'h0),
    .prog_arrived_in_n(1'b0), .prog_arrived_in_s(1'b0), .prog_arrived_in_e(1'b0), .prog_arrived_in_w(1'b0),
    .prog_ack_out_n(), .prog_ack_out_s(), .prog_ack_out_e(), .prog_ack_out_w(),
    .freeze_in(1'b0), .status_active(cmd_active), .status_freeze_state());

// ---------------- the sequencer (standalone sequencer_cell_v4), offers SOUTH into the carrier's north face
reg seq_cfgv = 1'b0; reg [63:0] seq_cfg = 64'h0; reg seq_active = 1'b0; reg use_seq = 1'b0;
wire [31:0] seq_dout; wire seq_fire;
sequencer_cell_v4 #(.CELL_ID(16'hA001)) SEQ (
    .clk(clk), .rst(rst), .active(seq_active), .cfg_valid(seq_cfgv), .cfg_data(seq_cfg),
    .data_in_n(32'h0), .data_in_s(32'h0), .data_in_e(32'h0), .data_in_w(32'h0),
    .arrived_n(1'b0), .arrived_s(1'b0), .arrived_e(1'b0), .arrived_w(1'b0),
    .data_out_n(), .data_out_s(seq_dout), .data_out_e(), .data_out_w(),
    .fire_n(), .fire_s(seq_fire), .fire_e(), .fire_w(),
    .ready_in_n(1'b1), .ready_in_s(1'b1), .ready_in_e(1'b1), .ready_in_w(1'b1),
    .ack_out_n(), .ack_out_s(), .ack_out_e(), .ack_out_w(),
    .ack_in_n(1'b0), .ack_in_s(car_ack_n), .ack_in_e(1'b0), .ack_in_w(1'b0),
    .program_in(1'b0), .program_done(),
    .prog_data_in_n(32'h0), .prog_data_in_s(32'h0), .prog_data_in_e(32'h0), .prog_data_in_w(32'h0),
    .prog_arrived_in_n(1'b0), .prog_arrived_in_s(1'b0), .prog_arrived_in_e(1'b0), .prog_arrived_in_w(1'b0),
    .prog_ack_out_n(), .prog_ack_out_s(), .prog_ack_out_e(), .prog_ack_out_w(),
    .freeze_in(1'b0), .ready_out(), .status_seq_index());

// ---------------- the carrier: cfg_valid is tied to 0 -- the command cell is the only thing that ever configures it
reg [31:0] val_n = 32'h0; reg arr_n = 1'b0; reg ack_e = 1'b0;
wire [31:0] dn = use_seq ? seq_dout : val_n; wire an = use_seq ? seq_fire : arr_n;
wire [31:0] dout_e; wire fire_e;
unicell_vix_carrier_v1dm #(.CELL_ID(16'hC200)) VIX (
    .clk(clk), .rst(rst),
    .active_in_n(1'b1), .active_in_s(1'b0), .active_in_e(1'b0), .active_in_w(1'b0),
    .freeze_in_n(1'b0), .freeze_in_s(1'b0), .freeze_in_e(1'b0), .freeze_in_w(cmd_fz_e),
    .cfg_valid(1'b0), .cfg_data(160'h0),
    .data_in_n(dn), .data_in_s(32'h0), .data_in_e(32'h0), .data_in_w(32'h0),
    .arrived_n(an), .arrived_s(1'b0), .arrived_e(1'b0), .arrived_w(1'b0),
    .data_out_n(), .data_out_s(), .data_out_e(dout_e), .data_out_w(),
    .fire_n(), .fire_s(), .fire_e(fire_e), .fire_w(),
    .ready_out(), .ready_in_n(1'b1), .ready_in_s(1'b1), .ready_in_e(1'b1), .ready_in_w(1'b1),
    .ack_out_n(car_ack_n), .ack_out_s(), .ack_out_e(), .ack_out_w(),
    .ack_in_n(1'b0), .ack_in_s(1'b0), .ack_in_e(ack_e), .ack_in_w(1'b0),
    .program_in(cmd_po_e), .program_done(),
    .prog_data_in_n(32'h0), .prog_data_in_s(32'h0), .prog_data_in_e(32'h0), .prog_data_in_w(cmd_pd_e),
    .prog_arrived_in_n(1'b0), .prog_arrived_in_s(1'b0), .prog_arrived_in_e(1'b0), .prog_arrived_in_w(cmd_pa_e),
    .prog_ack_out_n(), .prog_ack_out_s(), .prog_ack_out_e(), .prog_ack_out_w(car_pack_w),
    .freeze_out_n(), .freeze_out_s(), .freeze_out_e(), .freeze_out_w(),
    .program_out_n(), .program_out_s(), .program_out_e(), .program_out_w(),
    .prog_data_out_n(), .prog_data_out_s(), .prog_data_out_e(), .prog_data_out_w(),
    .prog_arrived_out_n(), .prog_arrived_out_s(), .prog_arrived_out_e(), .prog_arrived_out_w(),
    .prog_ack_in_n(1'b0), .prog_ack_in_s(1'b0), .prog_ack_in_e(1'b0), .prog_ack_in_w(1'b0),
    .status_core_select());

// ---------------- serial link
wire rx_v; wire [7:0] rx_d; board_uart_rx #(.CPB(CPB)) urx (.clk(clk), .rx(UART_RX), .valid(rx_v), .data(rx_d));
wire tx_busy; reg tx_start = 1'b0; reg [7:0] tx_data = 8'h00;
board_uart_tx #(.CPB(CPB)) utx (.clk(clk), .start(tx_start), .data(tx_data), .tx(UART_TX), .busy(tx_busy));

// ---------------- the frame engine
localparam [4:0] H_IDLE = 5'd0, H_WN = 5'd1, H_WB = 5'd2, H_WPRES = 5'd3, H_WSET = 5'd4, H_WEND = 5'd5,
                 H_DAT = 5'd6, H_A = 5'd7, H_AW = 5'd8, H_B = 5'd9, H_WAIT = 5'd10, H_SETTLE = 5'd11,
                 H_SQ = 5'd12, H_SRUN = 5'd13, H_SDRAIN = 5'd14, H_REPLY = 5'd15;
reg [4:0] st = H_IDLE; reg [4:0] nrx = 5'd0; reg [3:0] wcnt = 4'd0, widx = 4'd0; reg [1:0] bcnt = 2'd0; reg [23:0] wsh = 24'h0;
reg [31:0] wbuf [0:15]; reg prime = 1'b1, primed_run = 1'b0; reg [63:0] ops = 64'h0; reg [15:0] w = 16'd0; reg [23:0] tmo = 24'd0;
reg [31:0] tcnt = 32'd0; reg cnt_en = 1'b0; reg [31:0] result = 32'h0, lat = 32'h0;
reg [15:0] ncount = 16'd0, scount = 16'd0; reg [31:0] first_clk = 32'h0, total_clk = 32'h0, first_val = 32'h0, last_val = 32'h0;
reg [143:0] txq = 144'h0; reg [4:0] txn = 5'd0; reg [15:0] frames = 16'd0;
always @(posedge clk) begin
    seq_cfgv <= 1'b0; w_arr <= 1'b0; arr_n <= 1'b0; ack_e <= 1'b0; tx_start <= 1'b0;
    if (cnt_en) tcnt <= tcnt + 32'd1;
    if (rst) begin st <= H_IDLE; nrx <= 5'd0; txn <= 5'd0; cnt_en <= 1'b0; use_seq <= 1'b0; seq_active <= 1'b0; end
    else case (st)
        H_IDLE: if (prime && cmd_init_done && !cmd_cfgv && cmd_ready) begin
                    // power-up priming session: select the adder so the carrier's select state is known before the first host frame (see README)
                    wbuf[0] <= 32'h00000001; wbuf[1] <= 32'h00700001; wcnt <= 4'd2; widx <= 4'd0; tcnt <= 32'd0; cnt_en <= 1'b1; tmo <= 24'd0; prime <= 1'b0; primed_run <= 1'b1; st <= H_WPRES;
                end else if (rx_v) begin
                    nrx <= 5'd0;
                    if (rx_d == 8'h57) st <= H_WN;
                    else if (rx_d == 8'h44) st <= H_DAT;
                    else if (rx_d == 8'h53) st <= H_SQ;
                end
        // ---- W: words for the command cell
        H_WN:   if (rx_v) begin
                    if (rx_d == 8'd0 || rx_d > 8'd12) begin txq <= {8'h54, 136'h0}; txn <= 5'd1; st <= H_REPLY; end
                    else begin wcnt <= rx_d[3:0]; widx <= 4'd0; bcnt <= 2'd0; st <= H_WB; end
                end
        H_WB:   if (rx_v) begin
                    if (bcnt == 2'd3) begin wbuf[widx] <= {wsh, rx_d}; bcnt <= 2'd0;
                        if (widx + 4'd1 == wcnt) begin widx <= 4'd0; tcnt <= 32'd0; cnt_en <= 1'b1; tmo <= 24'd0; st <= H_WPRES; end else widx <= widx + 4'd1; end
                    else begin wsh <= {wsh[15:0], rx_d}; bcnt <= bcnt + 2'd1; end
                end
        H_WPRES: begin tmo <= tmo + 24'd1;
                    if (cmd_ready) begin w_val <= wbuf[widx]; w_arr <= 1'b1; widx <= widx + 4'd1; w <= 16'd0; st <= H_WSET; end
                    else if (tmo >= 24'd2000000) begin cnt_en <= 1'b0; txq <= {8'h54, 136'h0}; txn <= 5'd1; st <= H_REPLY; end
                end
        H_WSET: begin tmo <= tmo + 24'd1; w <= w + 16'd1; if (w == 16'd2) st <= (widx == wcnt) ? H_WEND : H_WPRES; end
        H_WEND: begin tmo <= tmo + 24'd1;
                    if (cmd_ready && !cmd_active) begin cnt_en <= 1'b0; if (primed_run) begin primed_run <= 1'b0; st <= H_IDLE; end else begin txq <= {8'h4B, tcnt, 104'h0}; txn <= 5'd5; st <= H_REPLY; end end
                    else if (tmo >= 24'd2000000) begin cnt_en <= 1'b0; txq <= {8'h54, 136'h0}; txn <= 5'd1; st <= H_REPLY; end
                end
        // ---- D: one operand pair from the wrapper
        H_DAT:  if (rx_v) begin ops <= {ops[55:0], rx_d}; nrx <= nrx + 5'd1; if (nrx == 5'd7) st <= H_A; end
        H_A:    begin val_n <= ops[63:32]; arr_n <= 1'b1; w <= 16'd0; st <= H_AW; end
        H_AW:   begin w <= w + 16'd1; if (w == 16'd16) begin w <= 16'd0; st <= H_B; end end
        H_B:    begin val_n <= ops[31:0]; arr_n <= 1'b1; tmo <= 24'd0; tcnt <= 32'd1; cnt_en <= 1'b1; st <= H_WAIT; end
        H_WAIT: begin tmo <= tmo + 24'd1;
                    if (fire_e) begin cnt_en <= 1'b0; result <= dout_e; lat <= tcnt; ack_e <= 1'b1; w <= 16'd0; st <= H_SETTLE; end
                    else if (tmo >= 24'd2000000) begin cnt_en <= 1'b0; txq <= {8'h54, 136'h0}; txn <= 5'd1; st <= H_REPLY; end
                end
        H_SETTLE: begin w <= w + 16'd1; if (w == 16'd64) begin txq <= {8'h52, result, lat, 72'h0}; txn <= 5'd9; st <= H_REPLY; end end
        // ---- S: the sequencer streams into the carrier, the wrapper takes ncount results
        H_SQ:   if (rx_v) begin
                    if (nrx < 5'd8) seq_cfg <= {seq_cfg[55:0], rx_d};
                    else if (nrx == 5'd8) ncount[15:8] <= rx_d;
                    nrx <= nrx + 5'd1;
                    if (nrx == 5'd9) begin ncount[7:0] <= rx_d; st <= H_SRUN; scount <= 16'd0; tcnt <= 32'd0; cnt_en <= 1'b1; tmo <= 24'd0; seq_cfgv <= 1'b1; use_seq <= 1'b1; seq_active <= 1'b1; end
                end
        H_SRUN: begin tmo <= tmo + 24'd1;
                    if (fire_e) begin
                        if (scount == 16'd0) begin first_clk <= tcnt; first_val <= dout_e; end
                        last_val <= dout_e; total_clk <= tcnt; scount <= scount + 16'd1; ack_e <= 1'b1; tmo <= 24'd0; st <= H_SDRAIN;
                    end else if (tmo >= 24'd2000000) begin cnt_en <= 1'b0; use_seq <= 1'b0; seq_active <= 1'b0; txq <= {8'h54, 136'h0}; txn <= 5'd1; st <= H_REPLY; end
                end
        H_SDRAIN: begin
                    if (!fire_e && !ack_e) begin
                        if (scount == ncount) begin cnt_en <= 1'b0; use_seq <= 1'b0; seq_active <= 1'b0; txq <= {8'h55, first_clk, total_clk, first_val, last_val, 8'h00}; txn <= 5'd17; st <= H_REPLY; end
                        else st <= H_SRUN;
                    end
                end
        H_REPLY: begin
                    if (txn == 5'd0) st <= H_IDLE;
                    else if (!tx_busy && !tx_start) begin tx_data <= txq[143:136]; tx_start <= 1'b1; txq <= {txq[135:0], 8'h00}; txn <= txn - 5'd1; end
                end
        default: st <= H_IDLE;
    endcase
    if (rx_v) frames <= frames + 16'd1;
end
reg [23:0] hb = 24'd0; always @(posedge clk) hb <= hb + 24'd1;
reg [23:0] blink = 24'd0; always @(posedge clk) begin if (cmd_active) blink <= 24'hFFFFFF; else if (blink != 24'd0) blink <= blink - 24'd1; end
assign LED0_N = ~hb[23]; assign LED1_N = ~(blink != 24'd0); assign LED2_N = ~(st != H_IDLE); assign LED3_N = ~(frames != 16'd0);
endmodule
