// lat_top.v -- GENERATED by tools/board_direct_latency_t3_v1.py (ledger #1209). T3: two input pins, edge to result latency, counted in 27 MHz clocks. Do not hand-edit.
`default_nettype none
module lat_top #(parameter [63:0] NAME = "lt3_idle", parameter integer STORM = 0, parameter integer NCYC = 2048, parameter integer GAPW = 17, parameter integer HOLDW = 16,
                 parameter integer CPB = 234, parameter integer TO = 300000, parameter integer WARM = 200000, parameter integer REPEAT = 40000000, parameter integer PRET = 4000000, parameter integer PRED = 100000) (
    input  wire BOARD_CLK, output wire UART_TX, input wire SENS0, input wire SENS1, output wire STIM, output wire STIM2,
    output wire LED0_N, output wire LED1_N, output wire LED2_N, output wire LED3_N, output wire LED4_N, output wire LED5_N
);
    wire clk = BOARD_CLK;
    function [7:0] hx(input [3:0] n); hx = (n < 4'd10) ? (8'd48 + {4'b0, n}) : (8'd55 + {4'b0, n}); endfunction
    function [63:0] h8(input [31:0] v); h8 = {hx(v[31:28]), hx(v[27:24]), hx(v[23:20]), hx(v[19:16]), hx(v[15:12]), hx(v[11:8]), hx(v[7:4]), hx(v[3:0])}; endfunction

    // same power-up reset as unit_top
    reg [15:0] rcnt = 0; wire rst = ~&rcnt; always @(posedge clk) if (rst) rcnt <= rcnt + 1'b1;
    reg cfg_done = 1'b0, cfg_valid = 1'b0;
    always @(posedge clk) begin cfg_valid <= 1'b0; if (rst) cfg_done <= 1'b0; else if (!cfg_done) begin cfg_valid <= 1'b1; cfg_done <= 1'b1; end end
    wire [4*32-1:0] lane_data; wire [3:0] lane_valid, lane_ack;
    wire [1*32-1:0] out_data;  wire [0:0] out_valid, out_ack;
    wire ready_line, direct_on, live_nz, live_two; wire [15:0] live_amt;
    sd_unit_v1 #(.LANES(4), .OUTS(1), .AW(10), .INIT_DIV(34), .FAST_DIV(2), .DESIGN_ID(32'h54524545), .NSENS(2), .DIRECT_RAW(0), .DIRECT_DEFAULT(1), .SENS_INVERT(0)) U (
        .clk(clk), .rst(rst), .sd_clk(), .sd_mosi(), .sd_miso(1'b1), .sd_cs_n(),
        .spi_sclk(1'b0), .spi_cs_n(1'b1), .spi_mosi(1'b0), .spi_miso(),
        .lane_data(lane_data), .lane_valid(lane_valid), .lane_ack(lane_ack), .out_data(out_data), .out_valid(out_valid), .out_ack(out_ack), .ready_line(ready_line),
        .sens_pins({SENS1, SENS0}), .direct_on(direct_on), .live_nz(live_nz), .live_two(live_two), .live_amt(live_amt));
    icm_parallel_reduction_tree_flex D (.clk(clk), .rst(rst), .cfg_valid(cfg_valid), .in_input_0_data(lane_data[0*32 +: 32]), .in_input_0_valid(lane_valid[0]), .in_input_0_ack(lane_ack[0]), .in_input_1_data(lane_data[1*32 +: 32]), .in_input_1_valid(lane_valid[1]), .in_input_1_ack(lane_ack[1]), .in_input_2_data(lane_data[2*32 +: 32]), .in_input_2_valid(lane_valid[2]), .in_input_2_ack(lane_ack[2]), .in_input_3_data(lane_data[3*32 +: 32]), .in_input_3_valid(lane_valid[3]), .in_input_3_ack(lane_ack[3]), .out_output_data(out_data[0*32 +: 32]), .out_output_valid(out_valid[0]), .out_output_ack(out_ack[0]));

    // ---- clocks: a free-running count, and a copy of the unit's 1 ms sample tick (same reset, period 27,000 clocks)
    reg [31:0] now = 32'd0; always @(posedge clk) now <= now + 1'b1;
    reg [14:0] tick = 15'd0; wire tick_hit = (tick == 15'd26999);
    always @(posedge clk) if (rst) tick <= 15'd0; else tick <= tick_hit ? 15'd0 : tick + 1'b1;
    reg [31:0] last_tick = 32'd0; always @(posedge clk) if (tick_hit) last_tick <= now;

    // ---- the free-running load (STORM lanes of xorshift32); its folded output is printed so it stays in the build
    reg [31:0] s0 = 32'h9E3779B9; wire [31:0] a0 = s0 ^ (s0 << 13); wire [31:0] b0 = a0 ^ (a0 >> 17); wire [31:0] c0 = b0 ^ (b0 << 5);
    always @(posedge clk) if (STORM != 0) s0 <= c0;
    reg [31:0] s1 = 32'h3C6EF372; wire [31:0] a1 = s1 ^ (s1 << 13); wire [31:0] b1 = a1 ^ (a1 >> 17); wire [31:0] c1 = b1 ^ (b1 << 5);
    always @(posedge clk) if (STORM != 0) s1 <= c1;
    reg [31:0] s2 = 32'hDAA66D2B; wire [31:0] a2 = s2 ^ (s2 << 13); wire [31:0] b2 = a2 ^ (a2 >> 17); wire [31:0] c2 = b2 ^ (b2 << 5);
    always @(posedge clk) if (STORM != 0) s2 <= c2;
    reg [31:0] s3 = 32'h78DDE6E4; wire [31:0] a3 = s3 ^ (s3 << 13); wire [31:0] b3 = a3 ^ (a3 >> 17); wire [31:0] c3 = b3 ^ (b3 << 5);
    always @(posedge clk) if (STORM != 0) s3 <= c3;
    reg [31:0] s4 = 32'h1715609D; wire [31:0] a4 = s4 ^ (s4 << 13); wire [31:0] b4 = a4 ^ (a4 >> 17); wire [31:0] c4 = b4 ^ (b4 << 5);
    always @(posedge clk) if (STORM != 0) s4 <= c4;
    reg [31:0] s5 = 32'hB54CDA56; wire [31:0] a5 = s5 ^ (s5 << 13); wire [31:0] b5 = a5 ^ (a5 >> 17); wire [31:0] c5 = b5 ^ (b5 << 5);
    always @(posedge clk) if (STORM != 0) s5 <= c5;
    reg [31:0] s6 = 32'h5384540F; wire [31:0] a6 = s6 ^ (s6 << 13); wire [31:0] b6 = a6 ^ (a6 >> 17); wire [31:0] c6 = b6 ^ (b6 << 5);
    always @(posedge clk) if (STORM != 0) s6 <= c6;
    reg [31:0] s7 = 32'hF1BBCDC8; wire [31:0] a7 = s7 ^ (s7 << 13); wire [31:0] b7 = a7 ^ (a7 >> 17); wire [31:0] c7 = b7 ^ (b7 << 5);
    always @(posedge clk) if (STORM != 0) s7 <= c7;
    reg [31:0] s8 = 32'h8FF34781; wire [31:0] a8 = s8 ^ (s8 << 13); wire [31:0] b8 = a8 ^ (a8 >> 17); wire [31:0] c8 = b8 ^ (b8 << 5);
    always @(posedge clk) if (STORM != 0) s8 <= c8;
    reg [31:0] s9 = 32'h2E2AC13A; wire [31:0] a9 = s9 ^ (s9 << 13); wire [31:0] b9 = a9 ^ (a9 >> 17); wire [31:0] c9 = b9 ^ (b9 << 5);
    always @(posedge clk) if (STORM != 0) s9 <= c9;
    reg [31:0] s10 = 32'hCC623AF3; wire [31:0] a10 = s10 ^ (s10 << 13); wire [31:0] b10 = a10 ^ (a10 >> 17); wire [31:0] c10 = b10 ^ (b10 << 5);
    always @(posedge clk) if (STORM != 0) s10 <= c10;
    reg [31:0] s11 = 32'h6A99B4AC; wire [31:0] a11 = s11 ^ (s11 << 13); wire [31:0] b11 = a11 ^ (a11 >> 17); wire [31:0] c11 = b11 ^ (b11 << 5);
    always @(posedge clk) if (STORM != 0) s11 <= c11;
    reg [31:0] s12 = 32'h08D12E65; wire [31:0] a12 = s12 ^ (s12 << 13); wire [31:0] b12 = a12 ^ (a12 >> 17); wire [31:0] c12 = b12 ^ (b12 << 5);
    always @(posedge clk) if (STORM != 0) s12 <= c12;
    reg [31:0] s13 = 32'hA708A81E; wire [31:0] a13 = s13 ^ (s13 << 13); wire [31:0] b13 = a13 ^ (a13 >> 17); wire [31:0] c13 = b13 ^ (b13 << 5);
    always @(posedge clk) if (STORM != 0) s13 <= c13;
    reg [31:0] s14 = 32'h454021D7; wire [31:0] a14 = s14 ^ (s14 << 13); wire [31:0] b14 = a14 ^ (a14 >> 17); wire [31:0] c14 = b14 ^ (b14 << 5);
    always @(posedge clk) if (STORM != 0) s14 <= c14;
    reg [31:0] s15 = 32'hE3779B90; wire [31:0] a15 = s15 ^ (s15 << 13); wire [31:0] b15 = a15 ^ (a15 >> 17); wire [31:0] c15 = b15 ^ (b15 << 5);
    always @(posedge clk) if (STORM != 0) s15 <= c15;
    reg [31:0] s16 = 32'h81AF1549; wire [31:0] a16 = s16 ^ (s16 << 13); wire [31:0] b16 = a16 ^ (a16 >> 17); wire [31:0] c16 = b16 ^ (b16 << 5);
    always @(posedge clk) if (STORM != 0) s16 <= c16;
    reg [31:0] s17 = 32'h1FE68F02; wire [31:0] a17 = s17 ^ (s17 << 13); wire [31:0] b17 = a17 ^ (a17 >> 17); wire [31:0] c17 = b17 ^ (b17 << 5);
    always @(posedge clk) if (STORM != 0) s17 <= c17;
    reg [31:0] s18 = 32'hBE1E08BB; wire [31:0] a18 = s18 ^ (s18 << 13); wire [31:0] b18 = a18 ^ (a18 >> 17); wire [31:0] c18 = b18 ^ (b18 << 5);
    always @(posedge clk) if (STORM != 0) s18 <= c18;
    reg [31:0] s19 = 32'h5C558274; wire [31:0] a19 = s19 ^ (s19 << 13); wire [31:0] b19 = a19 ^ (a19 >> 17); wire [31:0] c19 = b19 ^ (b19 << 5);
    always @(posedge clk) if (STORM != 0) s19 <= c19;
    reg [31:0] s20 = 32'hFA8CFC2D; wire [31:0] a20 = s20 ^ (s20 << 13); wire [31:0] b20 = a20 ^ (a20 >> 17); wire [31:0] c20 = b20 ^ (b20 << 5);
    always @(posedge clk) if (STORM != 0) s20 <= c20;
    reg [31:0] s21 = 32'h98C475E6; wire [31:0] a21 = s21 ^ (s21 << 13); wire [31:0] b21 = a21 ^ (a21 >> 17); wire [31:0] c21 = b21 ^ (b21 << 5);
    always @(posedge clk) if (STORM != 0) s21 <= c21;
    reg [31:0] s22 = 32'h36FBEF9F; wire [31:0] a22 = s22 ^ (s22 << 13); wire [31:0] b22 = a22 ^ (a22 >> 17); wire [31:0] c22 = b22 ^ (b22 << 5);
    always @(posedge clk) if (STORM != 0) s22 <= c22;
    reg [31:0] s23 = 32'hD5336958; wire [31:0] a23 = s23 ^ (s23 << 13); wire [31:0] b23 = a23 ^ (a23 >> 17); wire [31:0] c23 = b23 ^ (b23 << 5);
    always @(posedge clk) if (STORM != 0) s23 <= c23;
    (* keep *) reg [31:0] chk = 32'd0;
    always @(posedge clk) if (STORM != 0) chk <= chk ^ (s0 ^ s1 ^ s2 ^ s3 ^ s4 ^ s5 ^ s6 ^ s7 ^ s8 ^ s9 ^ s10 ^ s11 ^ s12 ^ s13 ^ s14 ^ s15 ^ s16 ^ s17 ^ s18 ^ s19 ^ s20 ^ s21 ^ s22 ^ s23);

    // ---- random numbers
    reg [31:0] lf = 32'hACE1BEEF; always @(posedge clk) lf <= {lf[30:0], lf[31] ^ lf[21] ^ lf[1] ^ lf[0]};

    // ---- the event loop (T3): gap, pick a new state of the two inputs, one or two edges, wait for the right result, hold and check
    reg [31:0] sA_mn = 32'hFFFFFFFF, sA_mx = 32'd0, sA_sm = 32'd0;
    reg [31:0] sB_mn = 32'hFFFFFFFF, sB_mx = 32'd0, sB_sm = 32'd0;
    reg [31:0] dA_mn = 32'hFFFFFFFF, dA_mx = 32'd0, dA_sm = 32'd0;
    reg [31:0] dB_mn = 32'hFFFFFFFF, dB_mx = 32'd0, dB_sm = 32'd0;
    reg stim_r = 1'b0, stim2_r = 1'b0; assign STIM = stim_r; assign STIM2 = stim2_r;
    reg [3:0] st = 4'd0; reg [31:0] t0 = 32'd0, cnt = 32'd0, to_cnt = 32'd0, to_fail = 32'd0, ncyc = 32'd0, bad = 32'd0, nd = 32'd0, dly = 32'd0;
    reg [1:0] tgt = 2'd0; reg [15:0] exp_amt = 16'd0; reg first1 = 1'b0, dual = 1'b0;
    wire [31:0] lat_a = now - t0, lat_b = now - last_tick;
    localparam S_WARM = 0, S_GAP = 1, S_PICK = 2, S_E1 = 3, S_D = 4, S_W = 5, S_HOLD = 6, S_DONE = 7, S_PRE = 8;
    reg [31:0] pre_hit = 32'd0, pre_hit1 = 32'd0, pre_n = 32'd0, pre_t = 32'd0;
    wire [1:0] nw = lf[1:0];
    wire [1:0] npop = {1'b0, nw[0]} + {1'b0, nw[1]};
    wire [1:0] cpop = {1'b0, stim_r} + {1'b0, stim2_r};
    wire ch0 = (nw[0] != stim_r), ch1 = (nw[1] != stim2_r);
    always @(posedge clk) begin
        case (st)
            S_WARM: if (!rst && now > WARM) begin st <= S_PRE; pre_t <= 32'd0; end
            S_PRE: begin
                // pre-flight: both pins toggle together, slowly, 16 times; PRED clocks after each toggle each input must equal its output
                pre_t <= pre_t + 1'b1;
                if (pre_t == 32'd0) begin stim_r <= ~stim_r; stim2_r <= ~stim2_r; end
                if (pre_t == PRED) begin if (SENS0 == stim_r) pre_hit <= pre_hit + 1'b1; if (SENS1 == stim2_r) pre_hit1 <= pre_hit1 + 1'b1; pre_n <= pre_n + 1'b1; end
                if (pre_t >= PRET) begin pre_t <= 32'd0; if (pre_n == 32'd16) begin if (pre_hit == 32'd16 && pre_hit1 == 32'd16) begin stim_r <= 1'b0; stim2_r <= 1'b0; st <= S_GAP; cnt <= 32'd2000 + {15'd0, lf[GAPW-1:0]}; end else st <= S_DONE; end end
            end
            S_GAP:  if (cnt == 0) st <= S_PICK; else cnt <= cnt - 1'b1;
            S_PICK: if (npop != cpop) begin
                        tgt <= nw; exp_amt <= {1'b0, npop, 13'd0}; dual <= ch0 && ch1; first1 <= (ch0 && ch1) ? lf[2] : ch1; dly <= {16'd0, lf[18:3]}; st <= S_E1;
                    end
            S_E1: begin
                t0 <= now; to_cnt <= 32'd0;
                if (first1) stim2_r <= tgt[1]; else stim_r <= tgt[0];
                st <= dual ? S_D : S_W;
            end
            S_D: begin
                to_cnt <= to_cnt + 1'b1;
                if (dly == 0) begin if (first1) stim_r <= tgt[0]; else stim2_r <= tgt[1]; st <= S_W; end
                else dly <= dly - 1'b1;
            end
            S_W: begin
                to_cnt <= to_cnt + 1'b1;
                if (live_amt == exp_amt) begin
                    if (dual) begin dA_mn <= (lat_a < dA_mn) ? lat_a : dA_mn; dA_mx <= (lat_a > dA_mx) ? lat_a : dA_mx; dA_sm <= dA_sm + lat_a; dB_mn <= (lat_b < dB_mn) ? lat_b : dB_mn; dB_mx <= (lat_b > dB_mx) ? lat_b : dB_mx; dB_sm <= dB_sm + lat_b; nd <= nd + 1'b1; end else begin sA_mn <= (lat_a < sA_mn) ? lat_a : sA_mn; sA_mx <= (lat_a > sA_mx) ? lat_a : sA_mx; sA_sm <= sA_sm + lat_a; sB_mn <= (lat_b < sB_mn) ? lat_b : sB_mn; sB_mx <= (lat_b > sB_mx) ? lat_b : sB_mx; sB_sm <= sB_sm + lat_b; end
                    cnt <= 32'd30000 + {16'd0, lf[HOLDW-1:0]}; st <= S_HOLD;
                end else if (to_cnt >= TO) begin to_fail <= to_fail + 1'b1; cnt <= 32'd30000 + {16'd0, lf[HOLDW-1:0]}; st <= S_HOLD; end
            end
            S_HOLD: if (cnt == 0) begin
                        if (live_amt != exp_amt) bad <= bad + 1'b1;
                        ncyc <= ncyc + 1'b1; cnt <= 32'd2000 + {15'd0, lf[GAPW-1:0]}; st <= (ncyc + 1 == NCYC) ? S_DONE : S_GAP;
                    end else cnt <= cnt - 1'b1;
            default: ;
        endcase
    end
    wire done = (st == S_DONE);
    wire [7:0] res_c = (pre_hit != 32'd16 || pre_hit1 != 32'd16) ? "L" : ((to_fail == 0 && bad == 0) ? "P" : "F");
    wire pass = (pre_hit == 32'd16) && (pre_hit1 == 32'd16) && (to_fail == 0) && (bad == 0);

    // ---- print the line once the run is over, then again every REPEAT clocks
    wire [8*226-1:0] line = {"UCT ", NAME, " res=", res_c, " n=", h8(ncyc), " to=", h8(to_fail), " pre=", h8(pre_hit), " p1=", h8(pre_hit1), " bad=", h8(bad), " nd=", h8(nd), " sA=", h8(sA_mn), ",", h8(sA_mx), ",", h8(sA_sm), " sB=", h8(sB_mn), ",", h8(sB_mx), ",", h8(sB_sm), " dA=", h8(dA_mn), ",", h8(dA_mx), ",", h8(dA_sm), " dB=", h8(dB_mn), ",", h8(dB_mx), ",", h8(dB_sm), " chk=", h8(chk), "\015\n"};
    reg [7:0] ci = 8'd0; reg [31:0] rep = 32'd0; reg sending = 1'b0; reg start = 1'b0; wire busy;
    board_uart_tx #(.CPB(CPB)) T (.clk(clk), .start(start), .data(line[((226-1)-ci)*8 +: 8]), .tx(UART_TX), .busy(busy));
    always @(posedge clk) begin
        start <= 1'b0;
        if (!done) begin sending <= 1'b0; ci <= 8'd0; rep <= 32'd0; end
        else if (!sending) begin if (rep >= REPEAT || rep == 0) begin sending <= 1'b1; ci <= 8'd0; rep <= 32'd1; end else rep <= rep + 1'b1; end
        else if (start) ci <= ci + 1'b1;          // the transmitter is latching line[ci] this cycle; move on to the next byte
        else if (!busy) begin
            if (ci == 226) begin sending <= 1'b0; end
            else start <= 1'b1;
        end
    end
    reg [24:0] hb = 25'd0; always @(posedge clk) hb <= hb + 1'b1;
    assign LED0_N = ~hb[24]; assign LED1_N = ~(done && pass); assign LED2_N = ~(done && !pass); assign LED3_N = ~done;
    assign LED4_N = ~stim_r; assign LED5_N = ~SENS0;      // the level sent out on pin 86, and the level seen on pin 72: they should blink together
endmodule
`default_nettype wire
