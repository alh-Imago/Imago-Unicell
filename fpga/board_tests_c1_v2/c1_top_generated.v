// c1_top.v -- GENERATED by tools/board_esp32_c1_v2.py (ledger #1217). C1: Tang as stopwatch for an ESP32 interrupt handler. Do not hand-edit.
`default_nettype none
module c1_top #(parameter [63:0] NAME = "c1_quiet", parameter integer STORM = 0, parameter integer NCYC = 2048, parameter integer GAPW = 16, parameter integer CPB = 234,
                parameter integer TO = 54000, parameter integer WARM = 27000000, parameter integer REPEAT = 40000000, parameter integer PRET = 2700000, parameter integer PRED = 1350000,
                parameter integer SPER = 700, parameter integer SRND = 11) (
    input  wire BOARD_CLK, output wire UART_TX, input wire RESP, output wire STIM, output wire STORMP,
    output wire LED0_N, output wire LED1_N, output wire LED2_N, output wire LED3_N, output wire LED4_N, output wire LED5_N
);
    wire clk = BOARD_CLK;
    function [7:0] hx(input [3:0] n); hx = (n < 4'd10) ? (8'd48 + {4'b0, n}) : (8'd55 + {4'b0, n}); endfunction
    function [63:0] h8(input [31:0] v); h8 = {hx(v[31:28]), hx(v[27:24]), hx(v[23:20]), hx(v[19:16]), hx(v[15:12]), hx(v[11:8]), hx(v[7:4]), hx(v[3:0])}; endfunction

    reg [15:0] rcnt = 0; wire rst = ~&rcnt; always @(posedge clk) if (rst) rcnt <= rcnt + 1'b1;
    reg resp_a = 1'b0, resp_s = 1'b0; always @(posedge clk) begin resp_a <= RESP; resp_s <= resp_a; end
    reg [31:0] now = 32'd0; always @(posedge clk) now <= now + 1'b1;
    reg [31:0] lf = 32'hACE1BEEF; always @(posedge clk) lf <= {lf[30:0], lf[31] ^ lf[21] ^ lf[1] ^ lf[0]};
    reg [31:0] lg = 32'h1BADB002; always @(posedge clk) lg <= {lg[30:0], lg[31] ^ lg[21] ^ lg[1] ^ lg[0]};

    reg stim_r = 1'b0; assign STIM = stim_r;
    reg storm_r = 1'b0; assign STORMP = storm_r;
    reg [3:0] st = 4'd0; reg [31:0] t0 = 32'd0, cnt = 32'd0, to_cnt = 32'd0, to_fail = 32'd0, ncyc = 32'd0, to_r = 32'd0, to_f = 32'd0, inv = 32'd0, nr = 32'd0, nf = 32'd0; reg bad_ev = 1'b0;
    reg [31:0] pre_hit = 32'd0, pre_n = 32'd0, pre_t = 32'd0;
    reg [31:0] r_mn = 32'hFFFFFFFF, r_mx = 32'd0, r_sm = 32'd0, f_mn = 32'hFFFFFFFF, f_mx = 32'd0, f_sm = 32'd0;
    reg [31:0] h0 = 32'd0, h1 = 32'd0, h2 = 32'd0, h3 = 32'd0, h4 = 32'd0, h5 = 32'd0;
    localparam S_WARM = 0, S_PRE = 1, S_GAP = 2, S_RGO = 3, S_RWAIT = 4, S_HOLD = 5, S_FGO = 6, S_FWAIT = 7, S_DONE = 8;
    wire [31:0] lat = now - t0;
    wire storm_on = (STORM != 0) && (st >= S_GAP) && (st != S_DONE);

    // the storm: STORMP toggles every SPER + (random 0..2^SRND-1) clocks while the events are being measured
    reg [31:0] sc = 32'd0;
    always @(posedge clk) begin
        if (!storm_on) sc <= 32'd0;
        else if (sc == 0) begin storm_r <= ~storm_r; sc <= SPER + {21'd0, lg[SRND-1:0]}; end
        else sc <= sc - 1'b1;
    end

    always @(posedge clk) begin
        case (st)
            S_WARM: if (!rst && now > WARM) begin st <= S_PRE; pre_t <= 32'd0; end
            S_PRE: begin
                pre_t <= pre_t + 1'b1;
                if (pre_t == 32'd0) stim_r <= ~stim_r;
                if (pre_t == PRED) begin if (resp_s == stim_r) pre_hit <= pre_hit + 1'b1; pre_n <= pre_n + 1'b1; end
                if (pre_t >= PRET) begin pre_t <= 32'd0; if (pre_n == 32'd16) begin if (pre_hit == 32'd16) begin stim_r <= 1'b0; st <= S_GAP; cnt <= 32'd30000 + {16'd0, lf[GAPW-1:0]}; end else st <= S_DONE; end end
            end
            S_GAP:  if (cnt == 0) st <= S_RGO; else cnt <= cnt - 1'b1;
            S_RGO:  begin stim_r <= 1'b1; bad_ev <= resp_s; t0 <= now; to_cnt <= 32'd0; st <= S_RWAIT; end
            S_RWAIT: begin
                to_cnt <= to_cnt + 1'b1;
                if (resp_s) begin
                    if (bad_ev) inv <= inv + 1'b1;          // the answer pin was already at the new level: nothing to time (follows an unanswered edge)
                    else begin
                    nr <= nr + 1'b1;
                    r_mn <= (lat < r_mn) ? lat : r_mn; r_mx <= (lat > r_mx) ? lat : r_mx; r_sm <= r_sm + lat;
                    if (lat < 54) h0 <= h0 + 1'b1; else if (lat < 135) h1 <= h1 + 1'b1; else if (lat < 270) h2 <= h2 + 1'b1; else if (lat < 540) h3 <= h3 + 1'b1; else if (lat < 1350) h4 <= h4 + 1'b1; else h5 <= h5 + 1'b1;
                    end
                    cnt <= 32'd30000 + {16'd0, lf[GAPW-1:0]}; st <= S_HOLD;
                end else if (to_cnt >= TO) begin to_fail <= to_fail + 1'b1; to_r <= to_r + 1'b1; cnt <= 32'd30000 + {16'd0, lf[GAPW-1:0]}; st <= S_HOLD; end
            end
            S_HOLD: if (cnt == 0) st <= S_FGO; else cnt <= cnt - 1'b1;
            S_FGO:  begin stim_r <= 1'b0; bad_ev <= ~resp_s; t0 <= now; to_cnt <= 32'd0; st <= S_FWAIT; end
            S_FWAIT: begin
                to_cnt <= to_cnt + 1'b1;
                if (!resp_s) begin
                    if (bad_ev) inv <= inv + 1'b1;
                    else begin
                    nf <= nf + 1'b1;
                    f_mn <= (lat < f_mn) ? lat : f_mn; f_mx <= (lat > f_mx) ? lat : f_mx; f_sm <= f_sm + lat;
                    if (lat < 54) h0 <= h0 + 1'b1; else if (lat < 135) h1 <= h1 + 1'b1; else if (lat < 270) h2 <= h2 + 1'b1; else if (lat < 540) h3 <= h3 + 1'b1; else if (lat < 1350) h4 <= h4 + 1'b1; else h5 <= h5 + 1'b1;
                    end
                    ncyc <= ncyc + 1'b1; cnt <= 32'd30000 + {16'd0, lf[GAPW-1:0]}; st <= (ncyc + 1 == NCYC) ? S_DONE : S_GAP;
                end else if (to_cnt >= TO) begin to_fail <= to_fail + 1'b1; to_f <= to_f + 1'b1; ncyc <= ncyc + 1'b1; cnt <= 32'd30000 + {16'd0, lf[GAPW-1:0]}; st <= (ncyc + 1 == NCYC) ? S_DONE : S_GAP; end
            end
            default: ;
        endcase
    end
    wire done = (st == S_DONE);
    wire [7:0] res_c = (pre_hit != 32'd16) ? "L" : ((to_fail == 0) ? "P" : "F");
    wire pass = (pre_hit == 32'd16) && (to_fail == 0);

    wire [8*221-1:0] line = {"UCC ", NAME, " res=", res_c, " n=", h8(ncyc), " tor=", h8(to_r), " tof=", h8(to_f), " inv=", h8(inv), " pre=", h8(pre_hit), " r=", h8(r_mn), ",", h8(r_mx), ",", h8(r_sm), " nr=", h8(nr), " f=", h8(f_mn), ",", h8(f_mx), ",", h8(f_sm), " nf=", h8(nf), " h=", h8(h0), ",", h8(h1), ",", h8(h2), ",", h8(h3), ",", h8(h4), ",", h8(h5), "\015\n"};
    reg [7:0] ci = 8'd0; reg [31:0] rep = 32'd0; reg sending = 1'b0; reg start = 1'b0; wire busy;
    board_uart_tx #(.CPB(CPB)) T (.clk(clk), .start(start), .data(line[((221-1)-ci)*8 +: 8]), .tx(UART_TX), .busy(busy));
    always @(posedge clk) begin
        start <= 1'b0;
        if (!done) begin sending <= 1'b0; ci <= 8'd0; rep <= 32'd0; end
        else if (!sending) begin if (rep >= REPEAT || rep == 0) begin sending <= 1'b1; ci <= 8'd0; rep <= 32'd1; end else rep <= rep + 1'b1; end
        else if (start) ci <= ci + 1'b1;
        else if (!busy) begin
            if (ci == 221) begin sending <= 1'b0; end
            else start <= 1'b1;
        end
    end
    reg [24:0] hb = 25'd0; always @(posedge clk) hb <= hb + 1'b1;
    assign LED0_N = ~hb[24]; assign LED1_N = ~(done && pass); assign LED2_N = ~(done && !pass); assign LED3_N = ~done;
    assign LED4_N = ~stim_r; assign LED5_N = ~resp_s;      // pin 86 level out, answer level in: they follow each other
endmodule
`default_nettype wire
