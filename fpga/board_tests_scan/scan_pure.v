// board_top_scan.v -- GENERATED by tools/board_scan_v1.py (ledger #1146); do not hand-edit.
`default_nettype none
`timescale 1ns / 1ps
module board_top_scan #(parameter integer CPB = 234, parameter integer TMO = 2097152) (
    input wire BOARD_CLK, input wire UART_RX, output wire UART_TX, output wire LED0_N, output wire LED1_N, output wire LED2_N, output wire LED3_N);
wire clk = BOARD_CLK;
reg [7:0] por_cnt = 8'h00; reg [3:0] srst_cnt = 4'd0; reg boot = 1'b1;
wire rst = (por_cnt != 8'hFF) || (srst_cnt != 4'd0);
always @(posedge clk) begin if (por_cnt != 8'hFF) por_cnt <= por_cnt + 8'd1; end

reg cfg_grid = 1'b0, cfg_acc = 1'b0, load_valid = 1'b0, load_has = 1'b1, rel = 1'b0, hold_r = 1'b0; reg [15:0] n_steps = 16'd0; reg [1:0] mode = 2'd1; reg [2:0] dly = 3'd4; reg [4:0] lag = 5'd0; reg [31:0] load_data = 32'h0;
wire busy, stopped, held_valid, take_o, scan_out, scan_en_w, scan_in_w; wire [15:0] steps; wire [31:0] held, take_d;
looped_cordic_pure_wrapper_v1 core (.clk(clk), .rst(rst), .cfg_grid(cfg_grid), .cfg_acc(cfg_acc), .n_steps(n_steps), .mode(mode), .feed_delay(dly), .trig_lag(lag),
    .load_valid(load_valid), .load_has(load_has), .load_data(load_data), .scan_hold(hold_r), .scan_en(scan_en_w), .scan_in(scan_in_w), .scan_out(scan_out),
    .release_pulse(rel), .busy(busy), .stopped(stopped), .steps_done(steps), .held_word(held), .held_valid(held_valid), .take_o(take_o), .take_data(take_d));

wire rx_v; wire [7:0] rx_d; board_uart_rx #(.CPB(CPB)) urx (.clk(clk), .rx(UART_RX), .valid(rx_v), .data(rx_d));
wire tx_busy; reg tx_start = 1'b0; reg [7:0] tx_data = 8'h00;
board_uart_tx #(.CPB(CPB)) utx (.clk(clk), .start(tx_start), .data(tx_data), .tx(UART_TX), .busy(tx_busy));

// image memory (256 bytes), synchronous read, registered write
reg [7:0] mem [0:255]; reg [7:0] rdata = 8'h00; reg [7:0] m_wa = 8'h00, m_wd = 8'h00, m_ra = 8'h00; reg m_we = 1'b0;
always @(posedge clk) begin if (m_we) mem[m_wa] <= m_wd; rdata <= mem[m_ra]; end
reg [7:0] stg [0:31]; reg [7:0] s_rd = 8'h00; reg [4:0] stg_a = 5'd0; reg stg_we = 1'b0; reg [7:0] stg_d = 8'h00;
always @(posedge clk) begin if (stg_we) stg[stg_a] <= stg_d; s_rd <= stg[stg_a]; end

function [31:0] crc8(input [31:0] c, input [7:0] b);
    integer i; reg [31:0] r;
    begin r = c ^ {24'd0, b}; for (i = 0; i < 8; i = i + 1) r = r[0] ? ((r >> 1) ^ 32'hEDB88320) : (r >> 1); crc8 = r; end
endfunction
function [7:0] hexch(input [3:0] n); begin hexch = (n < 4'd10) ? (8'h30 + {4'd0, n}) : (8'h57 + {4'd0, n}); end endfunction   // lower case a-f

reg [31:0] runclk = 32'd0; reg run_en = 1'b0; reg prev_stopped = 1'b0;
localparam [3:0] S_IDLE = 4'd0, S_COLL = 4'd1, S_REPLY = 4'd2, S_CAP = 4'd3, S_CTR = 4'd4, S_DARG = 4'd5, S_DPRE = 4'd6, S_DOUT = 4'd7, S_WRX = 4'd8, S_WCP = 4'd9, S_ATR = 4'd10, S_ASH = 4'd11;
reg [3:0] st = S_IDLE; reg [7:0] cmd = 8'h00; reg [2:0] nrx = 3'd0; reg [39:0] sh = 40'h0; reg [95:0] txq = 96'h0; reg [3:0] txn = 4'd0; reg [15:0] frames = 16'd0; reg pend_srst = 1'b0; reg [15:0] gap = 16'd0; localparam [15:0] GAP = 12 * CPB;
reg [7:0] mask = 8'h00; reg [15:0] ses = 16'd0; reg [15:0] sbase = 16'd0;
wire [15:0] tot_steps = steps + sbase;
reg [31:0] t_word = 32'h0; reg t_hv = 1'b0; reg [15:0] t_steps = 16'd0;
reg [10:0] cbit = 11'd0; reg [7:0] csh = 8'h00; reg [4:0] tcnt = 5'd0;
reg [2:0] dseq = 3'd0; reg [31:0] crc = 32'hFFFFFFFF; reg [5:0] pp = 6'd0; reg [1:0] ph = 2'd0; reg [6:0] oi = 7'd0; reg [15:0] dgap = 16'd0;
reg [5:0] wi = 6'd0; reg [15:0] wses = 16'd0; reg [7:0] wseq = 8'd0, wof = 8'd0; reg [23:0] rcrc = 24'h0; reg [5:0] ci = 6'd0; reg cph = 1'b0;
reg [31:0] tmo = 32'd0;
reg [7:0] tb0 = 8'h0, tb1 = 8'h0, tb2 = 8'h0, tb3 = 8'h0, tb4 = 8'h0, tb5 = 8'h0, tb6 = 8'h0; reg [3:0] ai = 4'd0;
reg [7:0] ash = 8'h00; reg [10:0] abit = 11'd0; reg [7:0] abyte = 8'd0; reg [1:0] aph = 2'd0; reg [2:0] c8 = 3'd0;

assign scan_en_w = ((st == S_CAP) && (cbit < 11'd132)) || ((st == S_ASH) && (aph == 2'd3) && (abit < 11'd132));
assign scan_in_w = (st == S_CAP) ? scan_out : ash[7];

// the byte at position oi of a dump line
wire [31:0] crcf = ~crc;
wire [6:0] dk = oi - 7'd34;
function [7:0] obyte(input [6:0] o, input [15:0] s, input [2:0] q, input [7:0] rd, input [31:0] cf);
    reg [6:0] k;
    begin
        k = o - 7'd34;
        if (o < 7'd16) case (o) 0: obyte = "U"; 1: obyte = "C"; 2: obyte = "S"; 3: obyte = " "; 4: obyte = "l"; 5: obyte = "c"; 6: obyte = "o"; 7: obyte = "r"; 8: obyte = "d"; 9: obyte = "i"; 10: obyte = "c"; 11: obyte = " ";
                         12: obyte = "s"; 13: obyte = "e"; 14: obyte = "s"; default: obyte = "="; endcase
        else if (o < 7'd20) obyte = hexch(s >> (4 * (19 - o)));
        else if (o < 7'd25) case (o) 20: obyte = " "; 21: obyte = "s"; 22: obyte = "e"; 23: obyte = "q"; default: obyte = "="; endcase
        else if (o == 7'd25) obyte = hexch({1'b0, q});
        else if (o < 7'd34) case (o) 26: obyte = " "; 27: obyte = "o"; 28: obyte = "f"; 29: obyte = "="; 30: obyte = "8"; 31: obyte = " "; 32: obyte = "d"; default: obyte = "="; endcase
        else if (o < 7'd98) obyte = k[0] ? hexch(rd[3:0]) : hexch(rd[7:4]);
        else if (o < 7'd103) case (o) 98: obyte = " "; 99: obyte = "c"; 100: obyte = "r"; 101: obyte = "c"; default: obyte = "="; endcase
        else if (o < 7'd111) obyte = hexch(cf >> (4 * (110 - o)));
        else if (o == 7'd111) obyte = 8'h0D;
        else obyte = 8'h0A;
    end
endfunction
wire [7:0] ob = obyte(oi, ses, dseq, rdata, crcf);
wire [7:0] trb = (tcnt == 0) ? t_word[31:24] : (tcnt == 1) ? t_word[23:16] : (tcnt == 2) ? t_word[15:8] : (tcnt == 3) ? t_word[7:0] : (tcnt == 4) ? {7'b0, t_hv} : (tcnt == 5) ? t_steps[15:8] : (tcnt == 6) ? t_steps[7:0] : 8'h00;
wire [7:0] dpb = (pp == 0) ? ses[15:8] : (pp == 1) ? ses[7:0] : (pp == 2) ? {5'b0, dseq} : (pp == 3) ? 8'd8 : rdata;
wire [7:0] newmask = mask | (8'd1 << wseq[2:0]);

always @(posedge clk) begin
    cfg_grid <= 1'b0; cfg_acc <= 1'b0; load_valid <= 1'b0; rel <= 1'b0; tx_start <= 1'b0; m_we <= 1'b0; stg_we <= 1'b0;
    prev_stopped <= stopped;
    if (st != S_REPLY) gap <= GAP;
    if (srst_cnt != 4'd0) srst_cnt <= srst_cnt - 4'd1;
    if (run_en && !stopped) runclk <= runclk + 32'd1;
    if (stopped && !prev_stopped) run_en <= 1'b0;
    if (rst) begin st <= S_IDLE; boot <= 1'b1; mode <= 2'd1; dly <= 3'd4; lag <= 5'd0; n_steps <= 16'd0; run_en <= 1'b0; runclk <= 32'd0; txn <= 4'd0; hold_r <= 1'b0; sbase <= 16'd0; load_has <= 1'b1; end
    else if (boot) begin cfg_grid <= 1'b1; boot <= 1'b0; end
    else case (st)
        S_IDLE: if (rx_v) begin
                    frames <= frames + 16'd1; cmd <= rx_d; nrx <= 3'd0; sh <= 40'h0; tmo <= 32'd0;
                    case (rx_d)
                        8'h58: begin pend_srst <= 1'b1; txq <= {8'h4B, 88'h0}; txn <= 4'd1; st <= S_REPLY; end                                  // X
                        8'h47: begin rel <= 1'b1; hold_r <= 1'b0; run_en <= 1'b1; runclk <= 32'd0; txq <= {8'h4B, 88'h0}; txn <= 4'd1; st <= S_REPLY; end   // G
                        8'h51: begin txq <= {8'h51, 4'b0, hold_r, held_valid, busy, stopped, tot_steps, held, runclk}; txn <= 4'd12; st <= S_REPLY; end    // Q
                        8'h43, 8'h4C: st <= S_COLL;                                                                                            // C L
                        8'h53: if (stopped || hold_r) begin t_word <= held; t_hv <= held_valid; t_steps <= tot_steps; ses <= ses + 16'd1; cbit <= 11'd0; st <= S_CAP; end   // S
                               else begin txq <= {8'h4E, 88'h0}; txn <= 4'd1; st <= S_REPLY; end
                        8'h44: st <= S_DARG;                                                                                                   // D
                        8'h57: begin crc <= 32'hFFFFFFFF; wi <= 6'd0; st <= S_WRX; end                                                          // W
                        8'h41: if (mask == 8'hFF) begin hold_r <= 1'b1; ai <= 4'd0; ph <= 2'd0; st <= S_ATR; end                                // A
                               else begin txq <= {8'h4E, 88'h0}; txn <= 4'd1; st <= S_REPLY; end
                        8'h4D: begin txq <= {8'h4D, mask, ses, 64'h0}; txn <= 4'd4; st <= S_REPLY; end                                          // M
                        8'h5A: begin mask <= 8'h00; txq <= {8'h4B, 88'h0}; txn <= 4'd1; st <= S_REPLY; end                                      // Z
                        default: ;
                    endcase
                end
        S_COLL: begin
                    tmo <= rx_v ? 32'd0 : tmo + 32'd1;
                    if (!rx_v && tmo >= TMO) begin txq <= {8'h54, 88'h0}; txn <= 4'd1; st <= S_REPLY; end
                    if (rx_v) begin
                        sh <= {sh[31:0], rx_d}; nrx <= nrx + 3'd1;
                        if (cmd == 8'h43 && nrx == 3'd4) begin mode <= sh[25:24]; n_steps <= {sh[23:16], sh[15:8]}; dly <= sh[2:0]; lag <= rx_d[4:0]; cfg_acc <= 1'b1; txq <= {8'h4B, 88'h0}; txn <= 4'd1; st <= S_REPLY; end
                        if (cmd == 8'h4C && nrx == 3'd3) begin load_data <= {sh[23:0], rx_d}; load_has <= 1'b1; load_valid <= 1'b1; run_en <= 1'b1; runclk <= 32'd0; txq <= {8'h4B, 88'h0}; txn <= 4'd1; st <= S_REPLY; end
                    end
                end
        S_REPLY: begin
                    if (gap != 16'd0) gap <= gap - 16'd1;
                    else if (txn == 4'd0 && !tx_busy && !tx_start) begin if (pend_srst) begin srst_cnt <= 4'd8; pend_srst <= 1'b0; end st <= S_IDLE; end
                    else if (!tx_busy && !tx_start) begin tx_data <= txq[95:88]; tx_start <= 1'b1; txq <= {txq[87:0], 8'h00}; txn <= txn - 4'd1; end
                end
        // ---- capture: recirculate the chain into the image memory, then the trailer
        S_CAP: begin
                    csh <= {csh[6:0], (cbit < 11'd132) ? scan_out : 1'b0};
                    if (cbit[2:0] == 3'd7) begin m_we <= 1'b1; m_wa <= cbit[10:3]; m_wd <= {csh[6:0], (cbit < 11'd132) ? scan_out : 1'b0}; end
                    if (cbit == 11'd1919) begin tcnt <= 5'd0; st <= S_CTR; end else cbit <= cbit + 11'd1;
                end
        S_CTR: begin
                    m_we <= 1'b1; m_wa <= 8'd240 + {3'b0, tcnt}; m_wd <= trb;
                    if (tcnt == 5'd15) begin txq <= {8'h4B, 88'h0}; txn <= 4'd1; st <= S_REPLY; end else tcnt <= tcnt + 5'd1;
                end
        // ---- dump chunk: CRC pre-pass over the 36 bytes, then the text line
        S_DARG: begin
                    tmo <= rx_v ? 32'd0 : tmo + 32'd1;
                    if (!rx_v && tmo >= TMO) begin txq <= {8'h54, 88'h0}; txn <= 4'd1; st <= S_REPLY; end
                    if (rx_v) begin
                        if (rx_d < 8'd8) begin dseq <= rx_d[2:0]; crc <= 32'hFFFFFFFF; pp <= 6'd0; ph <= 2'd0; st <= S_DPRE; end
                        else begin txq <= {8'h45, 88'h0}; txn <= 4'd1; st <= S_REPLY; end
                    end
                end
        S_DPRE: case (ph)
                    2'd0: begin m_ra <= {dseq, pp[4:0] - 5'd4}; ph <= 2'd1; end
                    2'd1: ph <= 2'd2;
                    default: begin crc <= crc8(crc, dpb); ph <= 2'd0;
                              if (pp == 6'd35) begin oi <= 7'd0; dgap <= GAP; st <= S_DOUT; end else pp <= pp + 6'd1; end
                endcase
        S_DOUT: if (dgap != 16'd0) dgap <= dgap - 16'd1;
                else case (ph)
                    2'd0: begin m_ra <= {dseq, dk[5:1]}; ph <= 2'd1; end
                    2'd1: ph <= 2'd2;
                    default: if (!tx_busy && !tx_start) begin
                                tx_data <= ob; tx_start <= 1'b1; ph <= 2'd0;
                                if (oi == 7'd112) st <= S_IDLE; else oi <= oi + 7'd1;
                             end
                endcase
        // ---- write chunk: stage, check, copy
        S_WRX: begin
                    tmo <= rx_v ? 32'd0 : tmo + 32'd1;
                    if (!rx_v && tmo >= TMO) begin txq <= {8'h54, 88'h0}; txn <= 4'd1; st <= S_REPLY; end
                    if (rx_v) begin
                        wi <= wi + 6'd1;
                        if (wi < 6'd36) crc <= crc8(crc, rx_d);
                        if (wi == 6'd0) wses[15:8] <= rx_d;
                        if (wi == 6'd1) wses[7:0] <= rx_d;
                        if (wi == 6'd2) wseq <= rx_d;
                        if (wi == 6'd3) wof <= rx_d;
                        if (wi >= 6'd4 && wi < 6'd36) begin stg_we <= 1'b1; stg_a <= wi[4:0] - 5'd4; stg_d <= rx_d; end
                        if (wi >= 6'd36 && wi < 6'd39) rcrc <= {rcrc[15:0], rx_d};
                        if (wi == 6'd39) begin
                            if (({rcrc, rx_d} == ~crc) && wseq < 8'd8 && wof == 8'd8) begin ci <= 6'd0; cph <= 1'b0; ph <= 2'd0; stg_a <= 5'd0; st <= S_WCP; end
                            else begin txq <= {8'h45, wseq, mask, 72'h0}; txn <= 4'd3; st <= S_REPLY; end
                        end
                    end
                end
        S_WCP: begin
                    if (!cph) begin stg_a <= ci[4:0]; cph <= 1'b1; end            // address set; s_rd valid two clocks on
                    else if (ph == 2'd0) ph <= 2'd1;
                    else begin
                        m_we <= 1'b1; m_wa <= {wseq[2:0], ci[4:0]}; m_wd <= s_rd; cph <= 1'b0; ph <= 2'd0;
                        if (ci == 6'd31) begin mask <= newmask; txq <= {8'h4B, wseq, newmask, 72'h0}; txn <= 4'd3; st <= S_REPLY; end else ci <= ci + 6'd1;
                    end
                end
        // ---- apply: trailer bytes, closing register, then shift the stream in
        S_ATR: case (ph)
                    2'd0: begin m_ra <= 8'd240 + {4'b0, ai}; ph <= 2'd1; end
                    2'd1: ph <= 2'd2;
                    default: begin
                        case (ai) 0: tb0 <= rdata; 1: tb1 <= rdata; 2: tb2 <= rdata; 3: tb3 <= rdata; 4: tb4 <= rdata; default: tb5 <= rdata; endcase
                        ph <= 2'd0;
                        if (ai == 4'd6) begin load_data <= {tb0, tb1, tb2, tb3}; load_has <= tb4[0]; load_valid <= 1'b1; sbase <= {tb5, rdata}; abit <= 11'd0; abyte <= 8'd0; aph <= 2'd0; st <= S_ASH; end
                        else ai <= ai + 4'd1;
                    end
                endcase
        S_ASH: case (aph)
                    2'd0: begin m_ra <= abyte; aph <= 2'd1; end
                    2'd1: aph <= 2'd2;
                    2'd2: begin ash <= rdata; c8 <= 3'd0; aph <= 2'd3; end
                    default: begin
                        ash <= {ash[6:0], 1'b0}; abit <= abit + 11'd1; c8 <= c8 + 3'd1;
                        if (c8 == 3'd7) begin
                            aph <= 2'd0;
                            if (abyte == 8'd239) begin txq <= {8'h4B, 88'h0}; txn <= 4'd1; st <= S_REPLY; end else abyte <= abyte + 8'd1;
                        end
                    end
                endcase
        default: st <= S_IDLE;
    endcase
end
reg [23:0] hb = 24'd0; always @(posedge clk) hb <= hb + 24'd1;
assign LED0_N = ~hb[23]; assign LED1_N = ~stopped; assign LED2_N = ~hold_r; assign LED3_N = ~(mask == 8'hFF);
endmodule
