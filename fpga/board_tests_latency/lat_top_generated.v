// lat_top.v -- GENERATED by tools/board_direct_latency_v1.py (ledger #1206). T2: input-pin edge to result latency, counted in 27 MHz clocks. Do not hand-edit.
`default_nettype none
module lat_top #(parameter [63:0] NAME = "lat_idle", parameter integer STORM = 0, parameter integer NCYC = 2048, parameter integer GAPW = 17, parameter integer HOLDW = 16,
                 parameter integer CPB = 234, parameter integer TO = 100000, parameter integer WARM = 200000, parameter integer REPEAT = 40000000) (
    input  wire BOARD_CLK, output wire UART_TX, input wire SENS0, output wire STIM,
    output wire LED0_N, output wire LED1_N, output wire LED2_N, output wire LED3_N
);
    wire clk = BOARD_CLK;
    function [7:0] hx(input [3:0] n); hx = (n < 4'd10) ? (8'd48 + {4'b0, n}) : (8'd55 + {4'b0, n}); endfunction
    function [63:0] h8(input [31:0] v); h8 = {hx(v[31:28]), hx(v[27:24]), hx(v[23:20]), hx(v[19:16]), hx(v[15:12]), hx(v[11:8]), hx(v[7:4]), hx(v[3:0])}; endfunction

    // same power-up reset as unit_top
    reg [15:0] rcnt = 0; wire rst = ~&rcnt; always @(posedge clk) if (rst) rcnt <= rcnt + 1'b1;
    reg cfg_done = 1'b0, cfg_valid = 1'b0;
    always @(posedge clk) begin cfg_valid <= 1'b0; if (rst) cfg_done <= 1'b0; else if (!cfg_done) begin cfg_valid <= 1'b1; cfg_done <= 1'b1; end end
    wire [4*32-1:0] lane_data; wire [3:0] lane_valid, lane_ack;
    wire [1*32-1:0] out_data;  wire [0:0] out_valid, out_ack;
    wire ready_line, direct_on, live_nz, live_two; wire [15:0] live_amt;
    sd_unit_v1 #(.LANES(4), .OUTS(1), .AW(10), .INIT_DIV(34), .FAST_DIV(2), .DESIGN_ID(32'h54524545), .NSENS(2), .DIRECT_RAW(0), .DIRECT_DEFAULT(1), .SENS_INVERT(0)) U (
        .clk(clk), .rst(rst), .sd_clk(), .sd_mosi(), .sd_miso(1'b1), .sd_cs_n(),
        .spi_sclk(1'b0), .spi_cs_n(1'b1), .spi_mosi(1'b0), .spi_miso(),
        .lane_data(lane_data), .lane_valid(lane_valid), .lane_ack(lane_ack), .out_data(out_data), .out_valid(out_valid), .out_ack(out_ack), .ready_line(ready_line),
        .sens_pins({1'b0, SENS0}), .direct_on(direct_on), .live_nz(live_nz), .live_two(live_two), .live_amt(live_amt));
    icm_parallel_reduction_tree_flex D (.clk(clk), .rst(rst), .cfg_valid(cfg_valid), .in_input_0_data(lane_data[0*32 +: 32]), .in_input_0_valid(lane_valid[0]), .in_input_0_ack(lane_ack[0]), .in_input_1_data(lane_data[1*32 +: 32]), .in_input_1_valid(lane_valid[1]), .in_input_1_ack(lane_ack[1]), .in_input_2_data(lane_data[2*32 +: 32]), .in_input_2_valid(lane_valid[2]), .in_input_2_ack(lane_ack[2]), .in_input_3_data(lane_data[3*32 +: 32]), .in_input_3_valid(lane_valid[3]), .in_input_3_ack(lane_ack[3]), .out_output_data(out_data[0*32 +: 32]), .out_output_valid(out_valid[0]), .out_output_ack(out_ack[0]));

    // ---- clocks: a free-running count, and a copy of the unit's 1 ms sample tick (same reset, period 27,000 clocks)
    reg [31:0] now = 32'd0; always @(posedge clk) now <= now + 1'b1;
    reg [14:0] tick = 15'd0; wire tick_hit = (tick == 15'd26999);
    always @(posedge clk) if (rst) tick <= 15'd0; else tick <= tick_hit ? 15'd0 : tick + 1'b1;
    reg [31:0] last_tick = 32'd0; always @(posedge clk) if (tick_hit) last_tick <= now;

    // ---- the free-running load (STORM lanes of xorshift32); its folded output is printed so it stays in the build
    reg [31:0] s0 = 32'h9E3779B9; wire [31:0] a0 = s0 ^ (s0 << 13); wire [31:0] b0 = a0 ^ (a0 >> 17); wire [31:0] c0 = b0 ^ (b0 << 5);
    always @(posedge clk) if (STORM != 0) s0 <= c0;
    reg [31:0] s1 = 32'h3C6EF372; wire [31:0] a1 = s1 ^ (s1 << 13); wire [31:0] b1 = a1 ^ (a1 >> 17); wire [31:0] c1 = b1 ^ (b1 << 5);
    always @(posedge clk) if (STORM != 0) s1 <= c1;
    reg [31:0] s2 = 32'hDAA66D2B; wire [31:0] a2 = s2 ^ (s2 << 13); wire [31:0] b2 = a2 ^ (a2 >> 17); wire [31:0] c2 = b2 ^ (b2 << 5);
    always @(posedge clk) if (STORM != 0) s2 <= c2;
    reg [31:0] s3 = 32'h78DDE6E4; wire [31:0] a3 = s3 ^ (s3 << 13); wire [31:0] b3 = a3 ^ (a3 >> 17); wire [31:0] c3 = b3 ^ (b3 << 5);
    always @(posedge clk) if (STORM != 0) s3 <= c3;
    reg [31:0] s4 = 32'h1715609D; wire [31:0] a4 = s4 ^ (s4 << 13); wire [31:0] b4 = a4 ^ (a4 >> 17); wire [31:0] c4 = b4 ^ (b4 << 5);
    always @(posedge clk) if (STORM != 0) s4 <= c4;
    reg [31:0] s5 = 32'hB54CDA56; wire [31:0] a5 = s5 ^ (s5 << 13); wire [31:0] b5 = a5 ^ (a5 >> 17); wire [31:0] c5 = b5 ^ (b5 << 5);
    always @(posedge clk) if (STORM != 0) s5 <= c5;
    reg [31:0] s6 = 32'h5384540F; wire [31:0] a6 = s6 ^ (s6 << 13); wire [31:0] b6 = a6 ^ (a6 >> 17); wire [31:0] c6 = b6 ^ (b6 << 5);
    always @(posedge clk) if (STORM != 0) s6 <= c6;
    reg [31:0] s7 = 32'hF1BBCDC8; wire [31:0] a7 = s7 ^ (s7 << 13); wire [31:0] b7 = a7 ^ (a7 >> 17); wire [31:0] c7 = b7 ^ (b7 << 5);
    always @(posedge clk) if (STORM != 0) s7 <= c7;
    reg [31:0] s8 = 32'h8FF34781; wire [31:0] a8 = s8 ^ (s8 << 13); wire [31:0] b8 = a8 ^ (a8 >> 17); wire [31:0] c8 = b8 ^ (b8 << 5);
    always @(posedge clk) if (STORM != 0) s8 <= c8;
    reg [31:0] s9 = 32'h2E2AC13A; wire [31:0] a9 = s9 ^ (s9 << 13); wire [31:0] b9 = a9 ^ (a9 >> 17); wire [31:0] c9 = b9 ^ (b9 << 5);
    always @(posedge clk) if (STORM != 0) s9 <= c9;
    reg [31:0] s10 = 32'hCC623AF3; wire [31:0] a10 = s10 ^ (s10 << 13); wire [31:0] b10 = a10 ^ (a10 >> 17); wire [31:0] c10 = b10 ^ (b10 << 5);
    always @(posedge clk) if (STORM != 0) s10 <= c10;
    reg [31:0] s11 = 32'h6A99B4AC; wire [31:0] a11 = s11 ^ (s11 << 13); wire [31:0] b11 = a11 ^ (a11 >> 17); wire [31:0] c11 = b11 ^ (b11 << 5);
    always @(posedge clk) if (STORM != 0) s11 <= c11;
    reg [31:0] s12 = 32'h08D12E65; wire [31:0] a12 = s12 ^ (s12 << 13); wire [31:0] b12 = a12 ^ (a12 >> 17); wire [31:0] c12 = b12 ^ (b12 << 5);
    always @(posedge clk) if (STORM != 0) s12 <= c12;
    reg [31:0] s13 = 32'hA708A81E; wire [31:0] a13 = s13 ^ (s13 << 13); wire [31:0] b13 = a13 ^ (a13 >> 17); wire [31:0] c13 = b13 ^ (b13 << 5);
    always @(posedge clk) if (STORM != 0) s13 <= c13;
    reg [31:0] s14 = 32'h454021D7; wire [31:0] a14 = s14 ^ (s14 << 13); wire [31:0] b14 = a14 ^ (a14 >> 17); wire [31:0] c14 = b14 ^ (b14 << 5);
    always @(posedge clk) if (STORM != 0) s14 <= c14;
    reg [31:0] s15 = 32'hE3779B90; wire [31:0] a15 = s15 ^ (s15 << 13); wire [31:0] b15 = a15 ^ (a15 >> 17); wire [31:0] c15 = b15 ^ (b15 << 5);
    always @(posedge clk) if (STORM != 0) s15 <= c15;
    reg [31:0] s16 = 32'h81AF1549; wire [31:0] a16 = s16 ^ (s16 << 13); wire [31:0] b16 = a16 ^ (a16 >> 17); wire [31:0] c16 = b16 ^ (b16 << 5);
    always @(posedge clk) if (STORM != 0) s16 <= c16;
    reg [31:0] s17 = 32'h1FE68F02; wire [31:0] a17 = s17 ^ (s17 << 13); wire [31:0] b17 = a17 ^ (a17 >> 17); wire [31:0] c17 = b17 ^ (b17 << 5);
    always @(posedge clk) if (STORM != 0) s17 <= c17;
    reg [31:0] s18 = 32'hBE1E08BB; wire [31:0] a18 = s18 ^ (s18 << 13); wire [31:0] b18 = a18 ^ (a18 >> 17); wire [31:0] c18 = b18 ^ (b18 << 5);
    always @(posedge clk) if (STORM != 0) s18 <= c18;
    reg [31:0] s19 = 32'h5C558274; wire [31:0] a19 = s19 ^ (s19 << 13); wire [31:0] b19 = a19 ^ (a19 >> 17); wire [31:0] c19 = b19 ^ (b19 << 5);
    always @(posedge clk) if (STORM != 0) s19 <= c19;
    reg [31:0] s20 = 32'hFA8CFC2D; wire [31:0] a20 = s20 ^ (s20 << 13); wire [31:0] b20 = a20 ^ (a20 >> 17); wire [31:0] c20 = b20 ^ (b20 << 5);
    always @(posedge clk) if (STORM != 0) s20 <= c20;
    reg [31:0] s21 = 32'h98C475E6; wire [31:0] a21 = s21 ^ (s21 << 13); wire [31:0] b21 = a21 ^ (a21 >> 17); wire [31:0] c21 = b21 ^ (b21 << 5);
    always @(posedge clk) if (STORM != 0) s21 <= c21;
    reg [31:0] s22 = 32'h36FBEF9F; wire [31:0] a22 = s22 ^ (s22 << 13); wire [31:0] b22 = a22 ^ (a22 >> 17); wire [31:0] c22 = b22 ^ (b22 << 5);
    always @(posedge clk) if (STORM != 0) s22 <= c22;
    reg [31:0] s23 = 32'hD5336958; wire [31:0] a23 = s23 ^ (s23 << 13); wire [31:0] b23 = a23 ^ (a23 >> 17); wire [31:0] c23 = b23 ^ (b23 << 5);
    always @(posedge clk) if (STORM != 0) s23 <= c23;
    (* keep *) reg [31:0] chk = 32'd0;
    always @(posedge clk) if (STORM != 0) chk <= chk ^ (s0 ^ s1 ^ s2 ^ s3 ^ s4 ^ s5 ^ s6 ^ s7 ^ s8 ^ s9 ^ s10 ^ s11 ^ s12 ^ s13 ^ s14 ^ s15 ^ s16 ^ s17 ^ s18 ^ s19 ^ s20 ^ s21 ^ s22 ^ s23);

    // ---- random numbers
    reg [31:0] lf = 32'hACE1BEEF; always @(posedge clk) lf <= {lf[30:0], lf[31] ^ lf[21] ^ lf[1] ^ lf[0]};

    // ---- the event loop: gap, rising edge, wait for the result, hold, falling edge, wait for the result
    reg [31:0] rA_mn = 32'hFFFFFFFF, rA_mx = 32'd0, rA_sm = 32'd0;
    reg [31:0] rB_mn = 32'hFFFFFFFF, rB_mx = 32'd0, rB_sm = 32'd0;
    reg [31:0] fA_mn = 32'hFFFFFFFF, fA_mx = 32'd0, fA_sm = 32'd0;
    reg [31:0] fB_mn = 32'hFFFFFFFF, fB_mx = 32'd0, fB_sm = 32'd0;
    reg stim_r = 1'b0; assign STIM = stim_r;
    reg [3:0] st = 4'd0; reg [31:0] t0 = 32'd0, cnt = 32'd0, to_cnt = 32'd0, to_fail = 32'd0, ncyc = 32'd0;
    wire [31:0] lat_a = now - t0, lat_b = now - last_tick;
    localparam S_WARM = 0, S_GAP = 1, S_RGO = 2, S_RWAIT = 3, S_HOLD = 4, S_FGO = 5, S_FWAIT = 6, S_DONE = 7;
    always @(posedge clk) begin
        case (st)
            S_WARM: if (!rst && now > WARM) begin st <= S_GAP; cnt <= 32'd2000 + {15'd0, lf[GAPW-1:0]}; end
            S_GAP:  if (cnt == 0) st <= S_RGO; else cnt <= cnt - 1'b1;
            S_RGO:  begin stim_r <= 1'b1; t0 <= now; to_cnt <= 32'd0; st <= S_RWAIT; end
            S_RWAIT: begin
                to_cnt <= to_cnt + 1'b1;
                if (live_amt != 16'd0) begin rA_mn <= (lat_a < rA_mn) ? lat_a : rA_mn; rA_mx <= (lat_a > rA_mx) ? lat_a : rA_mx; rA_sm <= rA_sm + lat_a; rB_mn <= (lat_b < rB_mn) ? lat_b : rB_mn; rB_mx <= (lat_b > rB_mx) ? lat_b : rB_mx; rB_sm <= rB_sm + lat_b; cnt <= 32'd3000 + {16'd0, lf[HOLDW-1:0]}; st <= S_HOLD; end
                else if (to_cnt >= TO) begin to_fail <= to_fail + 1'b1; cnt <= 32'd3000 + {16'd0, lf[HOLDW-1:0]}; st <= S_HOLD; end
            end
            S_HOLD: if (cnt == 0) st <= S_FGO; else cnt <= cnt - 1'b1;
            S_FGO:  begin stim_r <= 1'b0; t0 <= now; to_cnt <= 32'd0; st <= S_FWAIT; end
            S_FWAIT: begin
                to_cnt <= to_cnt + 1'b1;
                if (live_amt == 16'd0) begin fA_mn <= (lat_a < fA_mn) ? lat_a : fA_mn; fA_mx <= (lat_a > fA_mx) ? lat_a : fA_mx; fA_sm <= fA_sm + lat_a; fB_mn <= (lat_b < fB_mn) ? lat_b : fB_mn; fB_mx <= (lat_b > fB_mx) ? lat_b : fB_mx; fB_sm <= fB_sm + lat_b; ncyc <= ncyc + 1'b1; cnt <= 32'd2000 + {15'd0, lf[GAPW-1:0]}; st <= (ncyc + 1 == NCYC) ? S_DONE : S_GAP; end
                else if (to_cnt >= TO) begin to_fail <= to_fail + 1'b1; ncyc <= ncyc + 1'b1; cnt <= 32'd2000 + {15'd0, lf[GAPW-1:0]}; st <= (ncyc + 1 == NCYC) ? S_DONE : S_GAP; end
            end
            default: ;
        endcase
    end
    wire done = (st == S_DONE);
    wire [7:0] res_c = (to_fail == 0) ? "P" : "F";

    // ---- print the line once the run is over, then again every REPEAT clocks
    wire [8*176-1:0] line = {"UCT ", NAME, " res=", res_c, " n=", h8(ncyc), " to=", h8(to_fail), " rA=", h8(rA_mn), ",", h8(rA_mx), ",", h8(rA_sm), " rB=", h8(rB_mn), ",", h8(rB_mx), ",", h8(rB_sm), " fA=", h8(fA_mn), ",", h8(fA_mx), ",", h8(fA_sm), " fB=", h8(fB_mn), ",", h8(fB_mx), ",", h8(fB_sm), " chk=", h8(chk), "\015\n"};
    reg [7:0] ci = 8'd0; reg [31:0] rep = 32'd0; reg sending = 1'b0; reg start = 1'b0; wire busy;
    board_uart_tx #(.CPB(CPB)) T (.clk(clk), .start(start), .data(line[((176-1)-ci)*8 +: 8]), .tx(UART_TX), .busy(busy));
    always @(posedge clk) begin
        start <= 1'b0;
        if (!done) begin sending <= 1'b0; ci <= 8'd0; rep <= 32'd0; end
        else if (!sending) begin if (rep >= REPEAT || rep == 0) begin sending <= 1'b1; ci <= 8'd0; rep <= 32'd1; end else rep <= rep + 1'b1; end
        else if (start) ci <= ci + 1'b1;          // the transmitter is latching line[ci] this cycle; move on to the next byte
        else if (!busy) begin
            if (ci == 176) begin sending <= 1'b0; end
            else start <= 1'b1;
        end
    end
    reg [24:0] hb = 25'd0; always @(posedge clk) hb <= hb + 1'b1;
    assign LED0_N = ~hb[24]; assign LED1_N = ~(done && to_fail == 0); assign LED2_N = ~(done && to_fail != 0); assign LED3_N = ~done;
endmodule
`default_nettype wire
