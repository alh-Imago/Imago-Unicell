// pls_top.v -- GENERATED by tools/board_direct_pulse_t4_v1.py (ledger #1224). T4: pulse width at the input pin. Do not hand-edit.
`default_nettype none
module pls_top #(parameter [63:0] NAME = "pls_idle", parameter integer STORM = 0, parameter integer NP = 512, parameter integer GAPW = 17,
                 parameter integer CPB = 234, parameter integer WARM = 200000, parameter integer REPEAT = 40000000, parameter integer PRET = 4000000, parameter integer PRED = 100000) (
    input  wire BOARD_CLK, output wire UART_TX, input wire SENS0, output wire STIM,
    output wire LED0_N, output wire LED1_N, output wire LED2_N, output wire LED3_N, output wire LED4_N, output wire LED5_N
);
    wire clk = BOARD_CLK;
    function [7:0] hx(input [3:0] n); hx = (n < 4'd10) ? (8'd48 + {4'b0, n}) : (8'd55 + {4'b0, n}); endfunction
    function [63:0] h8(input [31:0] v); h8 = {hx(v[31:28]), hx(v[27:24]), hx(v[23:20]), hx(v[19:16]), hx(v[15:12]), hx(v[11:8]), hx(v[7:4]), hx(v[3:0])}; endfunction

    reg [15:0] rcnt = 0; wire rst = ~&rcnt; always @(posedge clk) if (rst) rcnt <= rcnt + 1'b1;
    reg cfg_done = 1'b0, cfg_valid = 1'b0;
    always @(posedge clk) begin cfg_valid <= 1'b0; if (rst) cfg_done <= 1'b0; else if (!cfg_done) begin cfg_valid <= 1'b1; cfg_done <= 1'b1; end end
    wire [4*32-1:0] lane_data; wire [3:0] lane_valid, lane_ack;
    wire [1*32-1:0] out_data;  wire [0:0] out_valid, out_ack;
    wire ready_line, direct_on, live_nz, live_two; wire [15:0] live_amt;
    sd_unit_v1 #(.LANES(4), .OUTS(1), .AW(10), .INIT_DIV(34), .FAST_DIV(2), .DESIGN_ID(32'h54524545), .NSENS(2), .DIRECT_RAW(0), .DIRECT_DEFAULT(1), .SENS_INVERT(0)) U (
        .clk(clk), .rst(rst), .sd_clk(), .sd_mosi(), .sd_miso(1'b1), .sd_cs_n(),
        .spi_sclk(1'b0), .spi_cs_n(1'b1), .spi_mosi(1'b0), .spi_miso(),
        .lane_data(lane_data), .lane_valid(lane_valid), .lane_ack(lane_ack), .out_data(out_data), .out_valid(out_valid), .out_ack(out_ack), .ready_line(ready_line),
        .sens_pins({1'b0, SENS0}), .direct_on(direct_on), .live_nz(live_nz), .live_two(live_two), .live_amt(live_amt));
    icm_parallel_reduction_tree_flex D (.clk(clk), .rst(rst), .cfg_valid(cfg_valid), .in_input_0_data(lane_data[0*32 +: 32]), .in_input_0_valid(lane_valid[0]), .in_input_0_ack(lane_ack[0]), .in_input_1_data(lane_data[1*32 +: 32]), .in_input_1_valid(lane_valid[1]), .in_input_1_ack(lane_ack[1]), .in_input_2_data(lane_data[2*32 +: 32]), .in_input_2_valid(lane_valid[2]), .in_input_2_ack(lane_ack[2]), .in_input_3_data(lane_data[3*32 +: 32]), .in_input_3_valid(lane_valid[3]), .in_input_3_ack(lane_ack[3]), .out_output_data(out_data[0*32 +: 32]), .out_output_valid(out_valid[0]), .out_output_ack(out_ack[0]));

    reg [31:0] now = 32'd0; always @(posedge clk) now <= now + 1'b1;
    reg [31:0] s0 = 32'h9E3779B9; wire [31:0] a0 = s0 ^ (s0 << 13); wire [31:0] b0 = a0 ^ (a0 >> 17); wire [31:0] c0 = b0 ^ (b0 << 5);
    always @(posedge clk) if (STORM != 0) s0 <= c0;
    reg [31:0] s1 = 32'h3C6EF372; wire [31:0] a1 = s1 ^ (s1 << 13); wire [31:0] b1 = a1 ^ (a1 >> 17); wire [31:0] c1 = b1 ^ (b1 << 5);
    always @(posedge clk) if (STORM != 0) s1 <= c1;
    reg [31:0] s2 = 32'hDAA66D2B; wire [31:0] a2 = s2 ^ (s2 << 13); wire [31:0] b2 = a2 ^ (a2 >> 17); wire [31:0] c2 = b2 ^ (b2 << 5);
    always @(posedge clk) if (STORM != 0) s2 <= c2;
    reg [31:0] s3 = 32'h78DDE6E4; wire [31:0] a3 = s3 ^ (s3 << 13); wire [31:0] b3 = a3 ^ (a3 >> 17); wire [31:0] c3 = b3 ^ (b3 << 5);
    always @(posedge clk) if (STORM != 0) s3 <= c3;
    reg [31:0] s4 = 32'h1715609D; wire [31:0] a4 = s4 ^ (s4 << 13); wire [31:0] b4 = a4 ^ (a4 >> 17); wire [31:0] c4 = b4 ^ (b4 << 5);
    always @(posedge clk) if (STORM != 0) s4 <= c4;
    reg [31:0] s5 = 32'hB54CDA56; wire [31:0] a5 = s5 ^ (s5 << 13); wire [31:0] b5 = a5 ^ (a5 >> 17); wire [31:0] c5 = b5 ^ (b5 << 5);
    always @(posedge clk) if (STORM != 0) s5 <= c5;
    reg [31:0] s6 = 32'h5384540F; wire [31:0] a6 = s6 ^ (s6 << 13); wire [31:0] b6 = a6 ^ (a6 >> 17); wire [31:0] c6 = b6 ^ (b6 << 5);
    always @(posedge clk) if (STORM != 0) s6 <= c6;
    reg [31:0] s7 = 32'hF1BBCDC8; wire [31:0] a7 = s7 ^ (s7 << 13); wire [31:0] b7 = a7 ^ (a7 >> 17); wire [31:0] c7 = b7 ^ (b7 << 5);
    always @(posedge clk) if (STORM != 0) s7 <= c7;
    reg [31:0] s8 = 32'h8FF34781; wire [31:0] a8 = s8 ^ (s8 << 13); wire [31:0] b8 = a8 ^ (a8 >> 17); wire [31:0] c8 = b8 ^ (b8 << 5);
    always @(posedge clk) if (STORM != 0) s8 <= c8;
    reg [31:0] s9 = 32'h2E2AC13A; wire [31:0] a9 = s9 ^ (s9 << 13); wire [31:0] b9 = a9 ^ (a9 >> 17); wire [31:0] c9 = b9 ^ (b9 << 5);
    always @(posedge clk) if (STORM != 0) s9 <= c9;
    reg [31:0] s10 = 32'hCC623AF3; wire [31:0] a10 = s10 ^ (s10 << 13); wire [31:0] b10 = a10 ^ (a10 >> 17); wire [31:0] c10 = b10 ^ (b10 << 5);
    always @(posedge clk) if (STORM != 0) s10 <= c10;
    reg [31:0] s11 = 32'h6A99B4AC; wire [31:0] a11 = s11 ^ (s11 << 13); wire [31:0] b11 = a11 ^ (a11 >> 17); wire [31:0] c11 = b11 ^ (b11 << 5);
    always @(posedge clk) if (STORM != 0) s11 <= c11;
    reg [31:0] s12 = 32'h08D12E65; wire [31:0] a12 = s12 ^ (s12 << 13); wire [31:0] b12 = a12 ^ (a12 >> 17); wire [31:0] c12 = b12 ^ (b12 << 5);
    always @(posedge clk) if (STORM != 0) s12 <= c12;
    reg [31:0] s13 = 32'hA708A81E; wire [31:0] a13 = s13 ^ (s13 << 13); wire [31:0] b13 = a13 ^ (a13 >> 17); wire [31:0] c13 = b13 ^ (b13 << 5);
    always @(posedge clk) if (STORM != 0) s13 <= c13;
    reg [31:0] s14 = 32'h454021D7; wire [31:0] a14 = s14 ^ (s14 << 13); wire [31:0] b14 = a14 ^ (a14 >> 17); wire [31:0] c14 = b14 ^ (b14 << 5);
    always @(posedge clk) if (STORM != 0) s14 <= c14;
    reg [31:0] s15 = 32'hE3779B90; wire [31:0] a15 = s15 ^ (s15 << 13); wire [31:0] b15 = a15 ^ (a15 >> 17); wire [31:0] c15 = b15 ^ (b15 << 5);
    always @(posedge clk) if (STORM != 0) s15 <= c15;
    reg [31:0] s16 = 32'h81AF1549; wire [31:0] a16 = s16 ^ (s16 << 13); wire [31:0] b16 = a16 ^ (a16 >> 17); wire [31:0] c16 = b16 ^ (b16 << 5);
    always @(posedge clk) if (STORM != 0) s16 <= c16;
    reg [31:0] s17 = 32'h1FE68F02; wire [31:0] a17 = s17 ^ (s17 << 13); wire [31:0] b17 = a17 ^ (a17 >> 17); wire [31:0] c17 = b17 ^ (b17 << 5);
    always @(posedge clk) if (STORM != 0) s17 <= c17;
    reg [31:0] s18 = 32'hBE1E08BB; wire [31:0] a18 = s18 ^ (s18 << 13); wire [31:0] b18 = a18 ^ (a18 >> 17); wire [31:0] c18 = b18 ^ (b18 << 5);
    always @(posedge clk) if (STORM != 0) s18 <= c18;
    reg [31:0] s19 = 32'h5C558274; wire [31:0] a19 = s19 ^ (s19 << 13); wire [31:0] b19 = a19 ^ (a19 >> 17); wire [31:0] c19 = b19 ^ (b19 << 5);
    always @(posedge clk) if (STORM != 0) s19 <= c19;
    reg [31:0] s20 = 32'hFA8CFC2D; wire [31:0] a20 = s20 ^ (s20 << 13); wire [31:0] b20 = a20 ^ (a20 >> 17); wire [31:0] c20 = b20 ^ (b20 << 5);
    always @(posedge clk) if (STORM != 0) s20 <= c20;
    reg [31:0] s21 = 32'h98C475E6; wire [31:0] a21 = s21 ^ (s21 << 13); wire [31:0] b21 = a21 ^ (a21 >> 17); wire [31:0] c21 = b21 ^ (b21 << 5);
    always @(posedge clk) if (STORM != 0) s21 <= c21;
    reg [31:0] s22 = 32'h36FBEF9F; wire [31:0] a22 = s22 ^ (s22 << 13); wire [31:0] b22 = a22 ^ (a22 >> 17); wire [31:0] c22 = b22 ^ (b22 << 5);
    always @(posedge clk) if (STORM != 0) s22 <= c22;
    reg [31:0] s23 = 32'hD5336958; wire [31:0] a23 = s23 ^ (s23 << 13); wire [31:0] b23 = a23 ^ (a23 >> 17); wire [31:0] c23 = b23 ^ (b23 << 5);
    always @(posedge clk) if (STORM != 0) s23 <= c23;
    (* keep *) reg [31:0] chk = 32'd0;
    always @(posedge clk) if (STORM != 0) chk <= chk ^ (s0 ^ s1 ^ s2 ^ s3 ^ s4 ^ s5 ^ s6 ^ s7 ^ s8 ^ s9 ^ s10 ^ s11 ^ s12 ^ s13 ^ s14 ^ s15 ^ s16 ^ s17 ^ s18 ^ s19 ^ s20 ^ s21 ^ s22 ^ s23);
    reg [31:0] lf = 32'hACE1BEEF; always @(posedge clk) lf <= {lf[30:0], lf[31] ^ lf[21] ^ lf[1] ^ lf[0]};

    function [31:0] wval(input [3:0] i); begin case (i) 4'd0: wval = 32'd54000; 4'd1: wval = 32'd27000; 4'd2: wval = 32'd20250; 4'd3: wval = 32'd13500; 4'd4: wval = 32'd6750; 4'd5: wval = 32'd2700; 4'd6: wval = 32'd1350; 4'd7: wval = 32'd540; 4'd8: wval = 32'd270; 4'd9: wval = 32'd135; 4'd10: wval = 32'd54; 4'd11: wval = 32'd27; default: wval = 32'd1; endcase end endfunction
    reg [31:0] cg0 = 32'd0; reg [31:0] cg1 = 32'd0; reg [31:0] cg2 = 32'd0; reg [31:0] cg3 = 32'd0; reg [31:0] cg4 = 32'd0; reg [31:0] cg5 = 32'd0; reg [31:0] cg6 = 32'd0; reg [31:0] cg7 = 32'd0; reg [31:0] cg8 = 32'd0; reg [31:0] cg9 = 32'd0; reg [31:0] cg10 = 32'd0; reg [31:0] cg11 = 32'd0;
    reg stim_r = 1'b0; assign STIM = stim_r;
    reg [3:0] st = 4'd0, wi = 4'd0; reg [31:0] cnt = 32'd0, pn = 32'd0, stale = 32'd0; reg seen = 1'b0;
    wire seen_now = seen | (live_amt != 16'd0);
    localparam S_WARM = 0, S_GAP = 1, S_RGO = 2, S_HI = 3, S_WATCH = 4, S_DONE = 7, S_PRE = 8;
    reg [31:0] pre_hit = 32'd0, pre_n = 32'd0, pre_t = 32'd0;
    always @(posedge clk) begin
        case (st)
            S_WARM: if (!rst && now > WARM) begin st <= S_PRE; pre_t <= 32'd0; end
            S_PRE: begin
                pre_t <= pre_t + 1'b1;
                if (pre_t == 32'd0) stim_r <= ~stim_r;
                if (pre_t == PRED) begin if (SENS0 == stim_r) pre_hit <= pre_hit + 1'b1; pre_n <= pre_n + 1'b1; end
                if (pre_t >= PRET) begin pre_t <= 32'd0; if (pre_n == 32'd16) begin if (pre_hit == 32'd16) begin stim_r <= 1'b0; st <= S_GAP; cnt <= 60000 + {15'd0, lf[GAPW-1:0]}; wi <= 4'd0; pn <= 32'd0; end else st <= S_DONE; end end
            end
            S_GAP: if (cnt == 0) begin if (live_amt != 16'd0) stale <= stale + 1'b1; st <= S_RGO; end else cnt <= cnt - 1'b1;
            S_RGO: begin stim_r <= 1'b1; cnt <= wval(wi) - 1'b1; seen <= 1'b0; st <= S_HI; end
            S_HI: begin
                if (live_amt != 16'd0) seen <= 1'b1;
                if (cnt == 0) begin stim_r <= 1'b0; cnt <= 28000; st <= S_WATCH; end else cnt <= cnt - 1'b1;
            end
            S_WATCH: begin
                if (live_amt != 16'd0) seen <= 1'b1;
                if (cnt == 0) begin
                    case (wi) 4'd0: if (seen_now) cg0 <= cg0 + 1'b1; 4'd1: if (seen_now) cg1 <= cg1 + 1'b1; 4'd2: if (seen_now) cg2 <= cg2 + 1'b1; 4'd3: if (seen_now) cg3 <= cg3 + 1'b1; 4'd4: if (seen_now) cg4 <= cg4 + 1'b1; 4'd5: if (seen_now) cg5 <= cg5 + 1'b1; 4'd6: if (seen_now) cg6 <= cg6 + 1'b1; 4'd7: if (seen_now) cg7 <= cg7 + 1'b1; 4'd8: if (seen_now) cg8 <= cg8 + 1'b1; 4'd9: if (seen_now) cg9 <= cg9 + 1'b1; 4'd10: if (seen_now) cg10 <= cg10 + 1'b1; 4'd11: if (seen_now) cg11 <= cg11 + 1'b1; default: ; endcase
                    cnt <= 60000 + {15'd0, lf[GAPW-1:0]};
                    if (pn + 1 == NP) begin pn <= 32'd0; if (wi == 4'd11) st <= S_DONE; else begin wi <= wi + 1'b1; st <= S_GAP; end end
                    else begin pn <= pn + 1'b1; st <= S_GAP; end
                end else cnt <= cnt - 1'b1;
            end
            default: ;
        endcase
    end
    wire done = (st == S_DONE);
    wire [7:0] res_c = (pre_hit != 32'd16) ? "L" : ((stale == 0) ? "P" : "F");

    wire [8*219-1:0] line = {"UCP ", NAME, " res=", res_c, " np=", h8(NP), " stale=", h8(stale), " pre=", h8(pre_hit), " w0=", h8(cg0), " w1=", h8(cg1), " w2=", h8(cg2), " w3=", h8(cg3), " w4=", h8(cg4), " w5=", h8(cg5), " w6=", h8(cg6), " w7=", h8(cg7), " w8=", h8(cg8), " w9=", h8(cg9), " w10=", h8(cg10), " w11=", h8(cg11), " chk=", h8(chk), "\015\n"};
    reg [7:0] ci = 8'd0; reg [31:0] rep = 32'd0; reg sending = 1'b0; reg start = 1'b0; wire busy;
    board_uart_tx #(.CPB(CPB)) T (.clk(clk), .start(start), .data(line[((219-1)-ci)*8 +: 8]), .tx(UART_TX), .busy(busy));
    always @(posedge clk) begin
        start <= 1'b0;
        if (!done) begin sending <= 1'b0; ci <= 8'd0; rep <= 32'd0; end
        else if (!sending) begin if (rep >= REPEAT || rep == 0) begin sending <= 1'b1; ci <= 8'd0; rep <= 32'd1; end else rep <= rep + 1'b1; end
        else if (start) ci <= ci + 1'b1;
        else if (!busy) begin
            if (ci == 219) begin sending <= 1'b0; end
            else start <= 1'b1;
        end
    end
    reg [24:0] hb = 25'd0; always @(posedge clk) hb <= hb + 1'b1;
    assign LED0_N = ~hb[24]; assign LED1_N = ~(done && stale == 0 && pre_hit == 32'd16); assign LED2_N = ~(done && (stale != 0 || pre_hit != 32'd16)); assign LED3_N = ~done;
    assign LED4_N = ~stim_r; assign LED5_N = ~SENS0;
endmodule
`default_nettype wire
