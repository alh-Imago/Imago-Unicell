// board_top_mutability1h.v -- GENERATED by tools/board_mutability_v1.py (ledger #1086); do not hand-edit.
`default_nettype none
`timescale 1ns / 1ps
module board_top_mutability1h #(parameter integer CPB = 234) (
    input wire BOARD_CLK, input wire UART_RX, output wire UART_TX, output wire LED0_N, output wire LED1_N, output wire LED2_N, output wire LED3_N);
wire clk = BOARD_CLK;
reg [7:0] por_cnt = 8'h00; wire rst = (por_cnt != 8'hFF); always @(posedge clk) if (rst) por_cnt <= por_cnt + 8'd1;
reg cfg_valid = 1'b0; reg [159:0] cfg_data = 160'h0;
reg [31:0] val_n = 32'h0; reg arr_n = 1'b0; reg ack_e = 1'b0;
wire [31:0] dout_e; wire fire_e;
unicell_vix_carrier_v1m #(.CELL_ID(16'hC200)) VIX (
    .clk(clk), .rst(rst),
    .active_in_n(1'b1), .active_in_s(1'b0), .active_in_e(1'b0), .active_in_w(1'b0),
    .freeze_in_n(1'b0), .freeze_in_s(1'b0), .freeze_in_e(1'b0), .freeze_in_w(1'b0),
    .cfg_valid(cfg_valid), .cfg_data(cfg_data),
    .data_in_n(val_n), .data_in_s(32'h0), .data_in_e(32'h0), .data_in_w(32'h0),
    .arrived_n(arr_n), .arrived_s(1'b0), .arrived_e(1'b0), .arrived_w(1'b0),
    .data_out_n(), .data_out_s(), .data_out_e(dout_e), .data_out_w(),
    .fire_n(), .fire_s(), .fire_e(fire_e), .fire_w(),
    .ready_out(), .ready_in_n(1'b1), .ready_in_s(1'b1), .ready_in_e(1'b1), .ready_in_w(1'b1),
    .ack_out_n(), .ack_out_s(), .ack_out_e(), .ack_out_w(),
    .ack_in_n(1'b0), .ack_in_s(1'b0), .ack_in_e(ack_e), .ack_in_w(1'b0),
    .program_in(1'b0), .program_done(),
    .prog_data_in_n(32'h0), .prog_data_in_s(32'h0), .prog_data_in_e(32'h0), .prog_data_in_w(32'h0),
    .prog_arrived_in_n(1'b0), .prog_arrived_in_s(1'b0), .prog_arrived_in_e(1'b0), .prog_arrived_in_w(1'b0),
    .prog_ack_out_n(), .prog_ack_out_s(), .prog_ack_out_e(), .prog_ack_out_w(),
    .freeze_out_n(), .freeze_out_s(), .freeze_out_e(), .freeze_out_w(),
    .program_out_n(), .program_out_s(), .program_out_e(), .program_out_w(),
    .prog_data_out_n(), .prog_data_out_s(), .prog_data_out_e(), .prog_data_out_w(),
    .prog_arrived_out_n(), .prog_arrived_out_s(), .prog_arrived_out_e(), .prog_arrived_out_w(),
    .prog_ack_in_n(1'b0), .prog_ack_in_s(1'b0), .prog_ack_in_e(1'b0), .prog_ack_in_w(1'b0),
    .status_core_select());
wire rx_v; wire [7:0] rx_d; board_uart_rx #(.CPB(CPB)) urx (.clk(clk), .rx(UART_RX), .valid(rx_v), .data(rx_d));
wire tx_busy; reg tx_start = 1'b0; reg [7:0] tx_data = 8'h00;
board_uart_tx #(.CPB(CPB)) utx (.clk(clk), .start(tx_start), .data(tx_data), .tx(UART_TX), .busy(tx_busy));
localparam [3:0] H_IDLE = 4'd0, H_CFG = 4'd1, H_CFGW = 4'd2, H_DAT = 4'd3, H_A = 4'd4, H_AW = 4'd5, H_B = 4'd6, H_WAIT = 4'd7, H_SETTLE = 4'd8, H_REPLY = 4'd9;
reg [3:0] st = H_IDLE; reg [4:0] nrx = 5'd0; reg [159:0] cfg_sh = 160'h0; reg [63:0] ops = 64'h0; reg [15:0] w = 16'd0; reg [19:0] tmo = 20'd0;
reg [39:0] txq = 40'h0; reg [2:0] txn = 3'd0; reg [31:0] result = 32'h0; reg ok_seen = 1'b0, bad_seen = 1'b0; reg [15:0] frames = 16'd0;
always @(posedge clk) begin
    cfg_valid <= 1'b0; arr_n <= 1'b0; ack_e <= 1'b0; tx_start <= 1'b0;
    if (rst) begin st <= H_IDLE; nrx <= 5'd0; txn <= 3'd0; end
    else case (st)
        H_IDLE: if (rx_v) begin
                    if (rx_d == 8'h43) begin st <= H_CFG; nrx <= 5'd0; end
                    else if (rx_d == 8'h44) begin st <= H_DAT; nrx <= 5'd0; end
                end
        H_CFG:  if (rx_v) begin cfg_sh <= {cfg_sh[151:0], rx_d}; nrx <= nrx + 5'd1;
                    if (nrx == 5'd19) begin st <= H_CFGW; w <= 16'd0; end end
        H_CFGW: begin w <= w + 16'd1; if (w == 16'd2) begin cfg_data <= cfg_sh; cfg_valid <= 1'b1; end
                    if (w == 16'd64) begin txq <= {8'h4B, 32'h0}; txn <= 3'd1; st <= H_REPLY; end end
        H_DAT:  if (rx_v) begin ops <= {ops[55:0], rx_d}; nrx <= nrx + 5'd1; if (nrx == 5'd7) begin st <= H_A; end end
        H_A:    begin val_n <= ops[63:32]; arr_n <= 1'b1; w <= 16'd0; st <= H_AW; end
        H_AW:   begin w <= w + 16'd1; if (w == 16'd16) begin w <= 16'd0; st <= H_B; end end
        H_B:    begin val_n <= ops[31:0]; arr_n <= 1'b1; tmo <= 20'd0; st <= H_WAIT; end
        H_WAIT: begin tmo <= tmo + 20'd1;
                    if (fire_e) begin result <= dout_e; ack_e <= 1'b1; w <= 16'd0; st <= H_SETTLE; end
                    else if (tmo >= 20'd60000) begin txq <= {8'h54, 32'h0}; txn <= 3'd1; st <= H_REPLY; end end
        H_SETTLE: begin w <= w + 16'd1; if (w == 16'd64) begin txq <= {8'h52, result}; txn <= 3'd5; st <= H_REPLY; end end
        H_REPLY: begin
                    if (txn == 3'd0) st <= H_IDLE;
                    else if (!tx_busy && !tx_start) begin tx_data <= txq[39:32]; tx_start <= 1'b1; txq <= {txq[31:0], 8'h00}; txn <= txn - 3'd1; end
                end
        default: st <= H_IDLE;
    endcase
    if (rx_v) frames <= frames + 16'd1;
end
reg [23:0] hb = 24'd0; always @(posedge clk) hb <= hb + 24'd1;
reg [23:0] blink = 24'd0; always @(posedge clk) begin if (cfg_valid) blink <= 24'hFFFFFF; else if (blink != 24'd0) blink <= blink - 24'd1; end
assign LED0_N = ~hb[23]; assign LED1_N = ~(blink != 24'd0); assign LED2_N = ~(st != H_IDLE); assign LED3_N = ~(frames != 16'd0);
endmodule
