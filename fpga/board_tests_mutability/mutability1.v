// board_top_mutability1.v -- GENERATED by tools/board_mutability_v1.py (ledger #1086); do not hand-edit.
`default_nettype none
`timescale 1ns / 1ps
module board_top_mutability1 #(parameter integer CPB = 234, parameter integer SETTLE = 131072) (
    input wire BOARD_CLK, output wire UART_TX, output wire LED0_N, output wire LED1_N, output wire LED2_N, output wire LED3_N);
wire clk = BOARD_CLK;
reg [7:0] por_cnt = 8'h00; wire rst = (por_cnt != 8'hFF); always @(posedge clk) if (rst) por_cnt <= por_cnt + 8'd1;
localparam [31:0] OPA = 32'h12345600, OPB = 32'h00000078;
// ---- phase table: carrier select, core config (128), add-on config (20), expected word
function [4:0] ph_sel(input [3:0] i); case (i)
    4'd0: ph_sel = 5'd1;
    4'd1: ph_sel = 5'd1;
    4'd2: ph_sel = 5'd1;
    4'd3: ph_sel = 5'd1;
    4'd4: ph_sel = 5'd1;
    4'd5: ph_sel = 5'd9;
    4'd6: ph_sel = 5'd1;
    default: ph_sel = 5'd0; endcase endfunction
function [127:0] ph_cfg(input [3:0] i); case (i)
    4'd0: ph_cfg = 128'h00000000000000000000000000000044;
    4'd1: ph_cfg = 128'h00000000000000000000000000001044;
    4'd2: ph_cfg = 128'h00000000000000000000000000000044;
    4'd3: ph_cfg = 128'h00000000000000000000000000000044;
    4'd4: ph_cfg = 128'h00000000000000000000000000000044;
    4'd5: ph_cfg = 128'h00000000000000000000000000000044;
    4'd6: ph_cfg = 128'h00000000000000000000000000000044;
    default: ph_cfg = 128'h0; endcase endfunction
function [19:0] ph_add(input [3:0] i); case (i)
    4'd0: ph_add = 20'h00000;
    4'd1: ph_add = 20'h00000;
    4'd2: ph_add = 20'h80000;
    4'd3: ph_add = 20'h0D000;
    4'd4: ph_add = 20'h00103;
    4'd5: ph_add = 20'h00000;
    4'd6: ph_add = 20'h00000;
    default: ph_add = 20'h0; endcase endfunction
function [31:0] ph_exp(input [3:0] i); case (i)
    4'd0: ph_exp = 32'h12345678;
    4'd1: ph_exp = 32'h12345588;
    4'd2: ph_exp = 32'hEDCBA987;
    4'd3: ph_exp = 32'h00123456;
    4'd4: ph_exp = 32'h12345600;
    4'd5: ph_exp = 32'h88885000;
    4'd6: ph_exp = 32'h12345678;
    default: ph_exp = 32'h0; endcase endfunction
reg cfg_valid = 1'b0; reg [159:0] cfg_data = 160'h0;
reg [31:0] val_n = 32'h0; reg arr_n = 1'b0; reg ack_e = 1'b0;
wire [31:0] dout_e; wire fire_e;
unicell_vix_carrier_v1m #(.CELL_ID(16'hC200)) VIX (
    .clk(clk), .rst(rst),
    .active_in_n(1'b1), .active_in_s(1'b0), .active_in_e(1'b0), .active_in_w(1'b0),
    .freeze_in_n(1'b0), .freeze_in_s(1'b0), .freeze_in_e(1'b0), .freeze_in_w(1'b0),
    .cfg_valid(cfg_valid), .cfg_data(cfg_data),
    .data_in_n(val_n), .data_in_s(32'h0), .data_in_e(32'h0), .data_in_w(32'h0),
    .arrived_n(arr_n), .arrived_s(1'b0), .arrived_e(1'b0), .arrived_w(1'b0),
    .data_out_n(), .data_out_s(), .data_out_e(dout_e), .data_out_w(),
    .fire_n(), .fire_s(), .fire_e(fire_e), .fire_w(),
    .ready_out(), .ready_in_n(1'b1), .ready_in_s(1'b1), .ready_in_e(1'b1), .ready_in_w(1'b1),
    .ack_out_n(), .ack_out_s(), .ack_out_e(), .ack_out_w(),
    .ack_in_n(1'b0), .ack_in_s(1'b0), .ack_in_e(ack_e), .ack_in_w(1'b0),
    .program_in(1'b0), .program_done(),
    .prog_data_in_n(32'h0), .prog_data_in_s(32'h0), .prog_data_in_e(32'h0), .prog_data_in_w(32'h0),
    .prog_arrived_in_n(1'b0), .prog_arrived_in_s(1'b0), .prog_arrived_in_e(1'b0), .prog_arrived_in_w(1'b0),
    .prog_ack_out_n(), .prog_ack_out_s(), .prog_ack_out_e(), .prog_ack_out_w(),
    .freeze_out_n(), .freeze_out_s(), .freeze_out_e(), .freeze_out_w(),
    .program_out_n(), .program_out_s(), .program_out_e(), .program_out_w(),
    .prog_data_out_n(), .prog_data_out_s(), .prog_data_out_e(), .prog_data_out_w(),
    .prog_arrived_out_n(), .prog_arrived_out_s(), .prog_arrived_out_e(), .prog_arrived_out_w(),
    .prog_ack_in_n(1'b0), .prog_ack_in_s(1'b0), .prog_ack_in_e(1'b0), .prog_ack_in_w(1'b0),
    .status_core_select());
// ---- the sequencer
localparam [3:0] S_CFG = 4'd0, S_CFGW = 4'd1, S_A = 4'd2, S_AW = 4'd3, S_B = 4'd4, S_WAIT = 4'd5, S_ACK = 4'd6, S_NEXT = 4'd7, S_DONE = 4'd8;
reg [3:0] st = S_CFG; reg [3:0] ph = 4'd0; reg [15:0] w = 16'd0; reg [19:0] tmo = 20'd0;
localparam [3:0] NPH = 4'd7;
reg [31:0] res [0:7]; reg [7:0] okm = 8'h00; reg [7:0] tom = 8'h00; reg done = 1'b0;
integer k; initial for (k = 0; k < 8; k = k + 1) res[k] = 32'h0;
wire [159:0] cfg_word = {3'b000, 2'b00, ph_add(ph), 2'b00, ph_cfg(ph) , ph_sel(ph)};
always @(posedge clk) begin
    cfg_valid <= 1'b0; arr_n <= 1'b0; ack_e <= 1'b0;
    if (rst) begin st <= S_CFG; ph <= 4'd0; w <= 16'd0; tmo <= 20'd0; okm <= 8'h00; tom <= 8'h00; done <= 1'b0; end
    else case (st)
        S_CFG:  begin if (w < 16'd32) w <= w + 16'd1; else begin cfg_data <= cfg_word; cfg_valid <= 1'b1; w <= 16'd0; st <= S_CFGW; end end
        S_CFGW: begin if (w < 16'd16) w <= w + 16'd1; else begin w <= 16'd0; st <= S_A; end end
        S_A:    begin val_n <= OPA; arr_n <= 1'b1; w <= 16'd0; st <= S_AW; end
        S_AW:   begin if (w < 16'd16) w <= w + 16'd1; else begin w <= 16'd0; st <= S_B; end end
        S_B:    begin val_n <= OPB; arr_n <= 1'b1; tmo <= 20'd0; st <= S_WAIT; end
        S_WAIT: begin
            tmo <= tmo + 20'd1;
            if (fire_e) begin res[ph] <= dout_e; okm[ph] <= (dout_e == ph_exp(ph)); ack_e <= 1'b1; w <= 16'd0; st <= S_NEXT; end
            else if (tmo >= 20'd60000) begin res[ph] <= 32'hDEAD0000 | {28'd0, ph}; tom[ph] <= 1'b1; w <= 16'd0; st <= S_NEXT; end
        end
        S_NEXT: begin if (w < 16'd64) w <= w + 16'd1; else begin w <= 16'd0; if (ph + 4'd1 == NPH) begin done <= 1'b1; st <= S_DONE; end else begin ph <= ph + 4'd1; st <= S_CFG; end end end
        default: ;
    endcase
end
wire pass = done && (okm[6:0] == 7'b1111111) && (tom == 8'h00);
function [7:0] hexch(input [3:0] v); hexch = (v < 4'd10) ? (8'h30 + v) : (8'h41 + v - 4'd10); endfunction
reg [9:0] mi = 10'd0;
function [7:0] msg_byte(input [9:0] i); begin case (i)
        10'd0: msg_byte = 8'h55;
        10'd1: msg_byte = 8'h43;
        10'd2: msg_byte = 8'h4D;
        10'd3: msg_byte = 8'h20;
        10'd4: msg_byte = 8'h6D;
        10'd5: msg_byte = 8'h75;
        10'd6: msg_byte = 8'h74;
        10'd7: msg_byte = 8'h61;
        10'd8: msg_byte = 8'h62;
        10'd9: msg_byte = 8'h69;
        10'd10: msg_byte = 8'h6C;
        10'd11: msg_byte = 8'h69;
        10'd12: msg_byte = 8'h74;
        10'd13: msg_byte = 8'h79;
        10'd14: msg_byte = 8'h31;
        10'd15: msg_byte = 8'h20;
        10'd16: msg_byte = 8'h72;
        10'd17: msg_byte = 8'h65;
        10'd18: msg_byte = 8'h73;
        10'd19: msg_byte = 8'h3D;
        10'd20: msg_byte = pass ? 8'h50 : 8'h46;
        10'd21: msg_byte = 8'h20;
        10'd22: msg_byte = 8'h6F;
        10'd23: msg_byte = 8'h6B;
        10'd24: msg_byte = 8'h3D;
        10'd25: msg_byte = hexch((okm >> 4) & 4'hF);
        10'd26: msg_byte = hexch((okm >> 0) & 4'hF);
        10'd27: msg_byte = 8'h20;
        10'd28: msg_byte = 8'h74;
        10'd29: msg_byte = 8'h6F;
        10'd30: msg_byte = 8'h3D;
        10'd31: msg_byte = hexch((tom >> 4) & 4'hF);
        10'd32: msg_byte = hexch((tom >> 0) & 4'hF);
        10'd33: msg_byte = 8'h20;
        10'd34: msg_byte = 8'h72;
        10'd35: msg_byte = 8'h3D;
        10'd36: msg_byte = hexch((res[0] >> 28) & 4'hF);
        10'd37: msg_byte = hexch((res[0] >> 24) & 4'hF);
        10'd38: msg_byte = hexch((res[0] >> 20) & 4'hF);
        10'd39: msg_byte = hexch((res[0] >> 16) & 4'hF);
        10'd40: msg_byte = hexch((res[0] >> 12) & 4'hF);
        10'd41: msg_byte = hexch((res[0] >> 8) & 4'hF);
        10'd42: msg_byte = hexch((res[0] >> 4) & 4'hF);
        10'd43: msg_byte = hexch((res[0] >> 0) & 4'hF);
        10'd44: msg_byte = 8'h2C;
        10'd45: msg_byte = hexch((res[1] >> 28) & 4'hF);
        10'd46: msg_byte = hexch((res[1] >> 24) & 4'hF);
        10'd47: msg_byte = hexch((res[1] >> 20) & 4'hF);
        10'd48: msg_byte = hexch((res[1] >> 16) & 4'hF);
        10'd49: msg_byte = hexch((res[1] >> 12) & 4'hF);
        10'd50: msg_byte = hexch((res[1] >> 8) & 4'hF);
        10'd51: msg_byte = hexch((res[1] >> 4) & 4'hF);
        10'd52: msg_byte = hexch((res[1] >> 0) & 4'hF);
        10'd53: msg_byte = 8'h2C;
        10'd54: msg_byte = hexch((res[2] >> 28) & 4'hF);
        10'd55: msg_byte = hexch((res[2] >> 24) & 4'hF);
        10'd56: msg_byte = hexch((res[2] >> 20) & 4'hF);
        10'd57: msg_byte = hexch((res[2] >> 16) & 4'hF);
        10'd58: msg_byte = hexch((res[2] >> 12) & 4'hF);
        10'd59: msg_byte = hexch((res[2] >> 8) & 4'hF);
        10'd60: msg_byte = hexch((res[2] >> 4) & 4'hF);
        10'd61: msg_byte = hexch((res[2] >> 0) & 4'hF);
        10'd62: msg_byte = 8'h2C;
        10'd63: msg_byte = hexch((res[3] >> 28) & 4'hF);
        10'd64: msg_byte = hexch((res[3] >> 24) & 4'hF);
        10'd65: msg_byte = hexch((res[3] >> 20) & 4'hF);
        10'd66: msg_byte = hexch((res[3] >> 16) & 4'hF);
        10'd67: msg_byte = hexch((res[3] >> 12) & 4'hF);
        10'd68: msg_byte = hexch((res[3] >> 8) & 4'hF);
        10'd69: msg_byte = hexch((res[3] >> 4) & 4'hF);
        10'd70: msg_byte = hexch((res[3] >> 0) & 4'hF);
        10'd71: msg_byte = 8'h2C;
        10'd72: msg_byte = hexch((res[4] >> 28) & 4'hF);
        10'd73: msg_byte = hexch((res[4] >> 24) & 4'hF);
        10'd74: msg_byte = hexch((res[4] >> 20) & 4'hF);
        10'd75: msg_byte = hexch((res[4] >> 16) & 4'hF);
        10'd76: msg_byte = hexch((res[4] >> 12) & 4'hF);
        10'd77: msg_byte = hexch((res[4] >> 8) & 4'hF);
        10'd78: msg_byte = hexch((res[4] >> 4) & 4'hF);
        10'd79: msg_byte = hexch((res[4] >> 0) & 4'hF);
        10'd80: msg_byte = 8'h2C;
        10'd81: msg_byte = hexch((res[5] >> 28) & 4'hF);
        10'd82: msg_byte = hexch((res[5] >> 24) & 4'hF);
        10'd83: msg_byte = hexch((res[5] >> 20) & 4'hF);
        10'd84: msg_byte = hexch((res[5] >> 16) & 4'hF);
        10'd85: msg_byte = hexch((res[5] >> 12) & 4'hF);
        10'd86: msg_byte = hexch((res[5] >> 8) & 4'hF);
        10'd87: msg_byte = hexch((res[5] >> 4) & 4'hF);
        10'd88: msg_byte = hexch((res[5] >> 0) & 4'hF);
        10'd89: msg_byte = 8'h2C;
        10'd90: msg_byte = hexch((res[6] >> 28) & 4'hF);
        10'd91: msg_byte = hexch((res[6] >> 24) & 4'hF);
        10'd92: msg_byte = hexch((res[6] >> 20) & 4'hF);
        10'd93: msg_byte = hexch((res[6] >> 16) & 4'hF);
        10'd94: msg_byte = hexch((res[6] >> 12) & 4'hF);
        10'd95: msg_byte = hexch((res[6] >> 8) & 4'hF);
        10'd96: msg_byte = hexch((res[6] >> 4) & 4'hF);
        10'd97: msg_byte = hexch((res[6] >> 0) & 4'hF);
        10'd98: msg_byte = 8'h0D;
        10'd99: msg_byte = 8'h0A;
        default: msg_byte = 8'h20; endcase end endfunction
localparam integer MSGLEN = 100;
wire tx_busy; reg tx_start = 1'b0; reg [7:0] tx_data = 8'h00; reg [31:0] gapc = 32'd0; reg [1:0] ps = 2'd0;
board_uart_tx #(.CPB(CPB)) utx (.clk(clk), .start(tx_start), .data(tx_data), .tx(UART_TX), .busy(tx_busy));
always @(posedge clk) begin
    tx_start <= 1'b0;
    case (ps)
        2'd0: if (done) begin mi <= 10'd0; ps <= 2'd1; end
        2'd1: if (!tx_busy && !tx_start) begin tx_data <= msg_byte(mi); tx_start <= 1'b1; ps <= 2'd2; end
        2'd2: if (tx_busy) begin if (mi == MSGLEN - 1) begin gapc <= 32'd0; ps <= 2'd3; end else begin mi <= mi + 10'd1; ps <= 2'd1; end end
        2'd3: if (!tx_busy) begin gapc <= gapc + 32'd1; if (gapc >= SETTLE * 4) ps <= 2'd0; end
    endcase
end
reg [23:0] hb = 24'd0; always @(posedge clk) hb <= hb + 24'd1;
assign LED0_N = ~hb[23]; assign LED1_N = ~pass; assign LED2_N = ~(done && !pass); assign LED3_N = ~done;
endmodule
