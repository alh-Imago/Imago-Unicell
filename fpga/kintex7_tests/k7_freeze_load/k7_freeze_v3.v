// SPDX-License-Identifier: CERN-OHL-P-2.0
// k7_freeze_v3.v -- GENERATED by tools/kintex_freeze_pack_v3.py (ledger #1250); do not hand-edit.
// Freeze, save and load of the Tang std_tree4 grid on the Kintex card (XC7K480T), over JTAG USER1 (BSCANE2, 2752-bit register).
// Layout of the scan, the command and the freeze semantics: see tools/kintex_freeze_pack_v3.py (header) and README.md.
`default_nettype none

module top #(parameter integer HB_BIT = 24) (
    input  wire CLK,      // 50 MHz, AA28, LVCMOS18
    output wire LED0,     // red    P30  = frozen
    output wire LED1,     // green  M30  = the run has delivered its results
    output wire LED2      // yellow N30  = heartbeat
);
    // ---- JTAG
    wire j_capture, j_shift, j_sel, j_tck, j_tdi, j_update, j_reset, j_runtest, j_drck, j_tms, j_tdo;
    BSCANE2 #(.JTAG_CHAIN(1)) bscan (
        .CAPTURE(j_capture), .DRCK(j_drck), .RESET(j_reset), .RUNTEST(j_runtest), .SEL(j_sel), .SHIFT(j_shift),
        .TCK(j_tck), .TDI(j_tdi), .TMS(j_tms), .UPDATE(j_update), .TDO(j_tdo));

    reg [2751:0] jsr = 2752'd0;
    wire [2751:0] jsnap;
    reg j_upd_q = 1'b0;
    reg [31:0] ctl_t = 32'hFFFFFFFF;
    reg go_tog = 1'b0, rel_tog = 1'b0, frz_tog = 1'b0, ld_tog = 1'b0;
    reg [31:0] ld_t = 32'd0, ld_sig = 32'd0, ld_last = 32'd0, ld_lastt = 32'd0; reg [7:0] ld_k = 8'd0, ld_ncap = 8'd0;
    reg [1663:0] ld_payload = 1664'd0;
    always @(posedge j_tck) begin
        j_upd_q <= j_sel && j_update;
        if (j_sel) begin
            if (j_capture) jsr <= jsnap;
            else if (j_shift) jsr <= {j_tdi, jsr[2751:1]};
        end
        if (j_sel && j_update && !j_upd_q && jsr[34]) begin           // Update-DR with the valid bit
            ctl_t <= jsr[31:0];
            if (jsr[32]) go_tog  <= ~go_tog;
            if (jsr[33]) rel_tog <= ~rel_tog;
            if (jsr[36]) frz_tog <= ~frz_tog;
            if (jsr[35]) begin                                          // load: capture the payload now, signal it to the clock domain
                ld_t <= jsr[95:64]; ld_ncap <= jsr[103:96]; ld_k <= jsr[111:104];
                ld_sig <= jsr[159:128]; ld_last <= jsr[191:160]; ld_lastt <= jsr[223:192];
                ld_payload <= jsr[2751:1088];
                ld_tog <= ~ld_tog;
            end
        end
    end
    assign j_tdo = jsr[0];

    // ---- toggles into the clock domain (two flops, then an edge)
    reg [2:0] go_s = 3'b000, rel_s = 3'b000, frz_s = 3'b000, ld_s = 3'b000;
    always @(posedge CLK) begin go_s <= {go_s[1:0], go_tog}; rel_s <= {rel_s[1:0], rel_tog}; frz_s <= {frz_s[1:0], frz_tog}; ld_s <= {ld_s[1:0], ld_tog}; end
    wire go_pulse = go_s[2] ^ go_s[1], rel_pulse = rel_s[2] ^ rel_s[1], frz_pulse = frz_s[2] ^ frz_s[1], ld_pulse = ld_s[2] ^ ld_s[1];

    // ---- run control: power-up delay, one automatic run with no freeze; every "go" restarts the run
    reg [7:0] por = 8'h00; wire por_done = &por; reg por_d = 1'b0;
    always @(posedge CLK) begin if (!por_done) por <= por + 8'd1; por_d <= por_done; end
    wire auto_go = por_done && !por_d;
    wire go_now = go_pulse || auto_go;

    reg rst_run = 1'b1; reg [4:0] rc = 5'd0, sc = 5'd0; reg started = 1'b0;
    reg [31:0] t = 32'd0; reg [7:0] k = 8'd0;
    reg frozen = 1'b0, armed = 1'b0; reg [31:0] T_lat = 32'hFFFFFFFF; reg [7:0] runno = 8'd0;
    reg [7:0] ncap = 8'd0; reg [31:0] sig = 32'd0, lastw = 32'd0, lastt = 32'd0;
    wire [31:0] od; wire tv;
    wire hit = armed && !frozen && started && !rst_run && (t == T_lat);   // the clock on which the count reaches T
    wire fz = frozen || hit;                                              // the freeze line: acts on THIS clock (cycle-exact)
    // the Tang top's own load schedule (time, cell, word), as a function so that it also evaluates at time zero in simulation
    function [79:0] sched(input [7:0] kk);
        reg [31:0] lt_; reg [15:0] lc_; reg [31:0] lw_;
        begin lt_ = 32'hFFFFFFFF; lc_ = 16'd0; lw_ = 32'd0; case (kk)
        8'd0: begin lt_ = 32'd44; lc_ = 16'd0; lw_ = 32'd1; end
        8'd1: begin lt_ = 32'd48; lc_ = 16'd2; lw_ = 32'd2; end
        8'd2: begin lt_ = 32'd52; lc_ = 16'd4; lw_ = 32'd3; end
        8'd3: begin lt_ = 32'd56; lc_ = 16'd6; lw_ = 32'd4; end
        8'd4: begin lt_ = 32'd344; lc_ = 16'd0; lw_ = 32'd100; end
        8'd5: begin lt_ = 32'd348; lc_ = 16'd2; lw_ = 32'd4294967246; end
        8'd6: begin lt_ = 32'd352; lc_ = 16'd4; lw_ = 32'd7; end
        8'd7: begin lt_ = 32'd356; lc_ = 16'd6; lw_ = 32'd0; end
        8'd8: begin lt_ = 32'd644; lc_ = 16'd0; lw_ = 32'd4294967295; end
        8'd9: begin lt_ = 32'd648; lc_ = 16'd2; lw_ = 32'd4294967294; end
        8'd10: begin lt_ = 32'd652; lc_ = 16'd4; lw_ = 32'd4294967293; end
        8'd11: begin lt_ = 32'd656; lc_ = 16'd6; lw_ = 32'd4294967292; end
        8'd12: begin lt_ = 32'd944; lc_ = 16'd0; lw_ = 32'd1000; end
        8'd13: begin lt_ = 32'd948; lc_ = 16'd2; lw_ = 32'd2000; end
        8'd14: begin lt_ = 32'd952; lc_ = 16'd4; lw_ = 32'd3000; end
        8'd15: begin lt_ = 32'd956; lc_ = 16'd6; lw_ = 32'd4000; end
        8'd16: begin lt_ = 32'd1244; lc_ = 16'd0; lw_ = 32'd123456; end
        8'd17: begin lt_ = 32'd1248; lc_ = 16'd2; lw_ = 32'd4294312975; end
        8'd18: begin lt_ = 32'd1252; lc_ = 16'd4; lw_ = 32'd42; end
        8'd19: begin lt_ = 32'd1256; lc_ = 16'd6; lw_ = 32'd17; end
        8'd20: begin lt_ = 32'd1544; lc_ = 16'd0; lw_ = 32'd2147484296; end
        8'd21: begin lt_ = 32'd1548; lc_ = 16'd2; lw_ = 32'd4294966296; end
        8'd22: begin lt_ = 32'd1552; lc_ = 16'd4; lw_ = 32'd5; end
        8'd23: begin lt_ = 32'd1556; lc_ = 16'd6; lw_ = 32'd5; end
        default: ; endcase sched = {lt_, lc_, lw_}; end
    endfunction
    wire [79:0] sr = sched(k);
    wire [31:0] lt = sr[79:48]; wire [15:0] lc = sr[47:32]; wire [31:0] lw = sr[31:0];
    wire ldv = started && !fz && (k < 8'd24) && (t == lt);
    wire cell_load = ld_pulse && !rst_run && started;
    always @(posedge CLK) begin
        if (go_now) begin
            rst_run <= 1'b1; rc <= 5'd0; sc <= 5'd0; started <= 1'b0; t <= 32'd0; k <= 8'd0; frozen <= 1'b0;
            armed <= go_pulse && (ctl_t != 32'hFFFFFFFF); T_lat <= go_pulse ? ctl_t : 32'hFFFFFFFF;
            ncap <= 8'd0; sig <= 32'd0; lastw <= 32'd0; lastt <= 32'd0; runno <= runno + 8'd1;
        end else begin
            if (rel_pulse) begin frozen <= 1'b0; armed <= 1'b0; end
            if (frz_pulse) frozen <= 1'b1;
            if (rst_run) begin rc <= rc + 5'd1; if (rc == 5'd15) rst_run <= 1'b0; end
            else if (!started) begin sc <= sc + 5'd1; if (sc == 5'd15) started <= 1'b1; end
            else begin
                if (hit) frozen <= 1'b1;
                else if (!fz) t <= t + 32'd1;
                if (ldv) k <= k + 8'd1;
                if (tv && !fz) begin ncap <= ncap + 8'd1; lastw <= od; lastt <= t; sig <= {sig[30:0], sig[31]} ^ od; end
            end
            if (cell_load) begin      // load wins: the driver's own state comes from the command, the grid stays frozen until a release
                t <= ld_t; k <= ld_k; ncap <= ld_ncap; sig <= ld_sig; lastw <= ld_last; lastt <= ld_lastt; frozen <= 1'b1; armed <= 1'b0;
            end
        end
    end

    wire [831:0] snap; wire [1663:0] dbg;
    std_tree4_frz dut (.clk(CLK), .rst(rst_run), .ld_valid(ldv), .ld_cell(lc), .ld_word(lw), .tap_valid(tv), .tap_data(od),
        .ext_arrived(16'b0), .ext_ack_in(16'b0), .ext_data_in({512{1'b0}}), .ext_fire(), .ext_data_out(),
        .freeze(fz), .snap(snap), .dbg(dbg), .dbg_load_en(cell_load), .dbg_in(ld_payload));

    wire [31:0] hw2 = {4'b0, rst_run, started, armed, frozen, runno, k, ncap};
    assign jsnap = {dbg, snap, 32'd0, lastt, T_lat, lastw, sig, hw2, t, 32'h46525A33};

    reg [26:0] hb = 27'd0; always @(posedge CLK) hb <= hb + 27'd1;
    assign LED0 = frozen;
    assign LED1 = (ncap == 8'd6);
    assign LED2 = hb[HB_BIT];
endmodule
