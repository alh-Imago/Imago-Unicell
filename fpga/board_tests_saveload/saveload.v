// board_top_saveload.v -- GENERATED by tools/board_saveload_v2.py (ledger #1099); do not hand-edit.
`default_nettype none
`timescale 1ns / 1ps
module board_top_saveload #(parameter integer CPB = 234) (
    input wire BOARD_CLK, input wire UART_RX, output wire UART_TX, output wire LED0_N, output wire LED1_N, output wire LED2_N, output wire LED3_N);
wire clk = BOARD_CLK;
reg [7:0] por_cnt = 8'h00; reg [3:0] srst_cnt = 4'd0; reg boot = 1'b1;
wire rst = (por_cnt != 8'hFF) || (srst_cnt != 4'd0);
always @(posedge clk) begin if (por_cnt != 8'hFF) por_cnt <= por_cnt + 8'd1; end

reg cfg_grid = 1'b0, cfg_acc = 1'b0, load_valid = 1'b0, rel = 1'b0; reg [15:0] n_steps = 16'd0; reg [1:0] mode = 2'd1; reg [2:0] dly = 3'd4; reg [4:0] lag = 5'd0; reg [31:0] load_data = 32'h0;
wire busy, stopped, held_valid, take_o; wire [15:0] steps; wire [31:0] held, take_d;
looped_cordic_stop_wrapper_v2 core (.clk(clk), .rst(rst), .cfg_grid(cfg_grid), .cfg_acc(cfg_acc), .n_steps(n_steps), .mode(mode), .feed_delay(dly), .trig_lag(lag),
    .load_valid(load_valid), .load_data(load_data), .release_pulse(rel), .busy(busy), .stopped(stopped), .steps_done(steps), .held_word(held), .held_valid(held_valid), .take_o(take_o), .take_data(take_d));

wire rx_v; wire [7:0] rx_d; board_uart_rx #(.CPB(CPB)) urx (.clk(clk), .rx(UART_RX), .valid(rx_v), .data(rx_d));
wire tx_busy; reg tx_start = 1'b0; reg [7:0] tx_data = 8'h00;
board_uart_tx #(.CPB(CPB)) utx (.clk(clk), .start(tx_start), .data(tx_data), .tx(UART_TX), .busy(tx_busy));

reg [31:0] runclk = 32'd0; reg run_en = 1'b0; reg prev_stopped = 1'b0;
localparam [2:0] S_IDLE = 3'd0, S_COLL = 3'd1, S_REPLY = 3'd2;
reg [2:0] st = S_IDLE; reg [7:0] cmd = 8'h00; reg [2:0] nrx = 3'd0; reg [39:0] sh = 40'h0; reg [95:0] txq = 96'h0; reg [3:0] txn = 4'd0; reg [15:0] frames = 16'd0; reg pend_srst = 1'b0; reg [15:0] gap = 16'd0; localparam [15:0] GAP = 12 * CPB;
always @(posedge clk) begin
    cfg_grid <= 1'b0; cfg_acc <= 1'b0; load_valid <= 1'b0; rel <= 1'b0; tx_start <= 1'b0;
    prev_stopped <= stopped;
    if (st != S_REPLY) gap <= GAP;                         // every reply waits GAP clocks (12 bit times) before its first byte
    if (srst_cnt != 4'd0) srst_cnt <= srst_cnt - 4'd1;     // the only driver of srst_cnt together with the soft-reset assignment below (same block)
    if (run_en && !stopped) runclk <= runclk + 32'd1;
    if (stopped && !prev_stopped) run_en <= 1'b0;
    if (rst) begin st <= S_IDLE; boot <= 1'b1; mode <= 2'd1; dly <= 3'd4; lag <= 5'd0; n_steps <= 16'd0; run_en <= 1'b0; runclk <= 32'd0; txn <= 4'd0; end
    else if (boot) begin cfg_grid <= 1'b1; boot <= 1'b0; end
    else case (st)
        S_IDLE: if (rx_v) begin
                    frames <= frames + 16'd1; cmd <= rx_d; nrx <= 3'd0; sh <= 40'h0;
                    if (rx_d == 8'h58) begin pend_srst <= 1'b1; txq <= {8'h4B, 88'h0}; txn <= 4'd1; st <= S_REPLY; end
                    else if (rx_d == 8'h47) begin rel <= 1'b1; run_en <= 1'b1; runclk <= 32'd0; txq <= {8'h4B, 88'h0}; txn <= 4'd1; st <= S_REPLY; end
                    else if (rx_d == 8'h51) begin txq <= {8'h51, 5'b0, held_valid, busy, stopped, steps, held, runclk}; txn <= 4'd12; st <= S_REPLY; end
                    else if (rx_d == 8'h43 || rx_d == 8'h4C) st <= S_COLL;
                end
        S_COLL: if (rx_v) begin
                    sh <= {sh[31:0], rx_d}; nrx <= nrx + 3'd1;
                    if (cmd == 8'h43 && nrx == 3'd4) begin mode <= sh[25:24]; n_steps <= {sh[23:16], sh[15:8]}; dly <= sh[2:0]; lag <= rx_d[4:0]; cfg_acc <= 1'b1; txq <= {8'h4B, 88'h0}; txn <= 4'd1; st <= S_REPLY; end
                    if (cmd == 8'h4C && nrx == 3'd3) begin load_data <= {sh[23:0], rx_d}; load_valid <= 1'b1; run_en <= 1'b1; runclk <= 32'd0; txq <= {8'h4B, 88'h0}; txn <= 4'd1; st <= S_REPLY; end
                end
        S_REPLY: begin
                    if (gap != 16'd0) gap <= gap - 16'd1;
                    else if (txn == 4'd0 && !tx_busy && !tx_start) begin if (pend_srst) begin srst_cnt <= 4'd8; pend_srst <= 1'b0; end st <= S_IDLE; end
                    else if (!tx_busy && !tx_start) begin tx_data <= txq[95:88]; tx_start <= 1'b1; txq <= {txq[87:0], 8'h00}; txn <= txn - 4'd1; end
                end
        default: st <= S_IDLE;
    endcase
end
reg [23:0] hb = 24'd0; always @(posedge clk) hb <= hb + 24'd1;
assign LED0_N = ~hb[23]; assign LED1_N = ~stopped; assign LED2_N = ~busy; assign LED3_N = ~(frames != 16'd0);
endmodule
